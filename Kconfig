## nrf/applications/asset_tracker_v2/src/cloud/cloud_codec/Kconfig
```kconfig
#
# Copyright (c) 2021 Nordic Semiconductor
#
# SPDX-License-Identifier: LicenseRef-Nordic-5-Clause
#

module = CLOUD_CODEC
module-str = Cloud codec
source "subsys/logging/Kconfig.template.log_config"

choice GOLIOTH_CODEC
	prompt "Codec type"

config GOLIOTH_CODEC_CBOR
	bool "CBOR"
	select TINYCBOR
	select CBOR_FLOATING_POINT
	help
	  This codec will use CBOR as payload.

config GOLIOTH_CODEC_JSON
	bool "JSON"
	help
	  This codec will use JSON as payload.

endchoice # GOLIOTH_CODEC
```

## samples/common/Kconfig
```kconfig
#
# Copyright (C) 2021-2022 Golioth, Inc.
#
# SPDX-License-Identifier: Apache-2.0
#

menuconfig GOLIOTH_SAMPLES_COMMON
	bool "Common helper code shared across multiple samples"
	help
	  Build and link common code that is shared across Golioth samples.

if GOLIOTH_SAMPLES_COMMON

config GOLIOTH_SAMPLE_HARDCODED_CREDENTIALS
	bool "Hardcoded credentials"
	default y
	help
	  Use hardcoded credentials in samples

if GOLIOTH_SAMPLE_HARDCODED_CREDENTIALS

if GOLIOTH_AUTH_METHOD_PSK

config GOLIOTH_SAMPLE_HARDCODED_PSK_ID
	string "PSK ID"
	help
	  Defines PSK ID used during DTLS handshake with Golioth server.

config GOLIOTH_SAMPLE_HARDCODED_PSK
	string "PSK"
	help
	  Defines PSK used during DTLS handshake with Golioth server.

endif # GOLIOTH_AUTH_METHOD_PSK

if GOLIOTH_AUTH_METHOD_CERT

config GOLIOTH_SAMPLE_HARDCODED_CRT_PATH
	string "Public certificate path"
	help
	  Path to client's public certificate.

	  Must be in DER (binary) format.

config GOLIOTH_SAMPLE_HARDCODED_KEY_PATH
	string "Private key path"
	help
	  Path to client's private key.

	  Must be in DER (binary) format.

endif # GOLIOTH_AUTH_METHOD_CERT

endif # GOLIOTH_SAMPLE_HARDCODED_CREDENTIALS

config GOLIOTH_SAMPLE_DHCP_BIND
	bool "DHCP for samples"
	depends on NET_L2_ETHERNET
	depends on NET_DHCPV4
	help
	  Obtain an IPv4 address from the DHCP server.

config GOLIOTH_SAMPLE_NRF91_LTE_MONITOR
	bool "nRF91 LTE monitor"
	default y
	depends on LOG
	depends on LTE_LINK_CONTROL
	help
	  LTE Link Control events monitor for nRF91.

config GOLIOTH_SAMPLE_SETTINGS_AUTOLOAD
	bool "Automatically load settings before main()"
	depends on SETTINGS
	help
	  Load settings automatically before running main() function. Enable it,
	  so that application does not need to call settings_load() manually.

config GOLIOTH_SAMPLE_SETTINGS_SHELL
	bool "Settings shell"
	depends on SHELL
	depends on SETTINGS
	depends on !SETTINGS_SHELL
	help
	  Golioth specific settings shell. Enable it when reading and
	  writing string based settings is desired. Look at Zephyr's
	  settings shell implementation (SETTINGS_SHELL) when byte
	  strings are needed to be handled as well.

config GOLIOTH_SAMPLE_WIFI
	bool "WiFi utilities for samples"
	depends on NET_L2_WIFI_MGMT
	help
	  Enable utilities for easy WiFi setup, mainly for use inside samples/.

config GOLIOTH_SAMPLE_WIFI_SETTINGS
	bool "Load SSID and PSK from settigs subsystem"
	default y if GOLIOTH_SYSTEM_SETTINGS
	depends on GOLIOTH_SAMPLE_WIFI
	depends on SETTINGS
	help
	  Load WiFi SSID and PSK from settings subsystem, from 'wifi/ssid' and
	  'wifi/psk' entries.

if GOLIOTH_SAMPLE_WIFI && !GOLIOTH_SAMPLE_WIFI_SETTINGS

config GOLIOTH_SAMPLE_WIFI_SSID
	string "WiFi SSID"
	help
	  WiFi SSID used when connecting to WiFi AP.

config GOLIOTH_SAMPLE_WIFI_PSK
	string "WiFi PSK"
	help
	  WiFi PSK used when connecting to WiFi AP. Leave empty if connecting to
	  unsecure (open) AP.

endif # GOLIOTH_SAMPLE_WIFI && !GOLIOTH_SAMPLE_WIFI_SETTINGS

config GOLIOTH_SAMPLE_TEST_CONNECT_TIMEOUT
	int "Test connect timeout"
	default 120 if NRF_MODEM_LIB
	default 30
	help
	  Connect timeout used by Pytest scripts to wait for initial
	  connection/communication with DUT.

	  Not used by the sample code itself.

endif # GOLIOTH_SAMPLES_COMMON
```

## samples/common/Kconfig.defconfig
```kconfig
#
# Copyright (C) 2022-2023 Golioth, Inc.
#
# SPDX-License-Identifier: Apache-2.0
#

if GOLIOTH_SAMPLES_COMMON

if DNS_RESOLVER

config DNS_SERVER_IP_ADDRESSES
	default y

config DNS_SERVER1
	default "1.1.1.1"

endif # DNS_RESOLVER

if MBEDTLS

config MBEDTLS_ENABLE_HEAP
	default y

if MBEDTLS_ENABLE_HEAP

config MBEDTLS_HEAP_SIZE
	default 49152 if GOLIOTH_AUTH_METHOD_CERT && NRF_SECURITY
	default 32768 if GOLIOTH_AUTH_METHOD_CERT
	default 10240

endif # MBEDTLS_ENABLE_HEAP

if MBEDTLS_BUILTIN

config MBEDTLS_SSL_MAX_CONTENT_LEN
	default 4096 if GOLIOTH_AUTH_METHOD_CERT
	default 2048

endif # MBEDTLS_BUILTIN

if NRF_SECURITY

config MBEDTLS_SSL_IN_CONTENT_LEN
	int
	default 4096 if GOLIOTH_AUTH_METHOD_CERT
	default 2048

config MBEDTLS_SSL_OUT_CONTENT_LEN
	int
	default 4096 if GOLIOTH_AUTH_METHOD_CERT
	default 2048

endif # NRF_SECURITY

endif # MBEDTLS

config NETWORKING
	default y

config NET_IPV4
	default y

config NET_IPV6
	default n

config MAIN_STACK_SIZE
	default 4096

config MINIMAL_LIBC_MALLOC_ARENA_SIZE
	default 2048 if MINIMAL_LIBC

config GOLIOTH
	default y

config GOLIOTH_SYSTEM_CLIENT
	default y if GOLIOTH

config LOG_PROCESS_THREAD_STACK_SIZE
	default 2048 if LOG_BACKEND_GOLIOTH

config GOLIOTH_SYSTEM_SERVER_HOST
	default "$(GOLIOTH_SYSTEM_SERVER_HOST)" if "$(GOLIOTH_SYSTEM_SERVER_HOST)" != ""

if GOLIOTH_AUTH_METHOD_PSK

config GOLIOTH_SYSTEM_CLIENT_PSK_ID
	default "$(GOLIOTH_SYSTEM_CLIENT_PSK_ID)" if "$(GOLIOTH_SYSTEM_CLIENT_PSK_ID)" != ""

config GOLIOTH_SYSTEM_CLIENT_PSK
	default "$(GOLIOTH_SYSTEM_CLIENT_PSK)" if "$(GOLIOTH_SYSTEM_CLIENT_PSK)" != ""

endif # GOLIOTH_AUTH_METHOD_PSK

if GOLIOTH_AUTH_METHOD_CERT

config GOLIOTH_SYSTEM_CLIENT_CA_PATH
	default "$(GOLIOTH_SYSTEM_CLIENT_CA_PATH)" if "$(GOLIOTH_SYSTEM_CLIENT_CA_PATH)" != ""

config GOLIOTH_SYSTEM_CLIENT_CRT_PATH
	default "$(GOLIOTH_SYSTEM_CLIENT_CRT_PATH)" if "$(GOLIOTH_SYSTEM_CLIENT_CRT_PATH)" != ""

config GOLIOTH_SYSTEM_CLIENT_KEY_PATH
	default "$(GOLIOTH_SYSTEM_CLIENT_KEY_PATH)" if "$(GOLIOTH_SYSTEM_CLIENT_KEY_PATH)" != ""

endif # GOLIOTH_AUTH_METHOD_CERT

if GOLIOTH_SAMPLE_WIFI && !GOLIOTH_SAMPLE_WIFI_SETTINGS

config GOLIOTH_SAMPLE_WIFI_SSID
	default "$(GOLIOTH_SAMPLE_WIFI_SSID)" if "$(GOLIOTH_SAMPLE_WIFI_SSID)" != ""

config GOLIOTH_SAMPLE_WIFI_PSK
	default "$(GOLIOTH_SAMPLE_WIFI_PSK)" if "$(GOLIOTH_SAMPLE_WIFI_PSK)" != ""

endif # GOLIOTH_SAMPLE_WIFI && !GOLIOTH_SAMPLE_WIFI_SETTINGS

endif # GOLIOTH_SAMPLES_COMMON
```

## samples/hello/boards/qemu_cortex_m3.conf
```kconfig
# Kernel options
CONFIG_ENTROPY_GENERATOR=y
CONFIG_TEST_RANDOM_GENERATOR=y

# Static networking
CONFIG_NET_CONFIG_MY_IPV4_ADDR="192.0.2.1"
CONFIG_NET_CONFIG_PEER_IPV4_ADDR="192.0.2.2"
```

## samples/hello/boards/qemu_x86.conf
```kconfig
# Kernel options
CONFIG_ENTROPY_GENERATOR=y
CONFIG_TEST_RANDOM_GENERATOR=y

# Use SLIRP, so that root access for setting up TUN/TAP is not required
CONFIG_NET_QEMU_USER=y
CONFIG_PCIE=y
CONFIG_ETH_E1000=y
CONFIG_NET_L2_ETHERNET=y

# Static networking
CONFIG_NET_CONFIG_LOG_LEVEL_DBG=y
CONFIG_NET_CONFIG_SETTINGS=y
CONFIG_NET_CONFIG_NEED_IPV4=y

CONFIG_NET_CONFIG_MY_IPV4_ADDR="10.0.2.1"
CONFIG_NET_CONFIG_MY_IPV4_GW="10.0.2.2"
CONFIG_NET_CONFIG_PEER_IPV4_ADDR="10.0.2.2"
```

## tests/connected_diconnected/testcase.yaml
```yaml
tests:
  net.golioth.connected_disconnected:
    platform_allow: qemu_x86
    tags: golioth net goliothd
```

## tests/lightdb/testcase.yaml
```yaml
tests:
  net.golioth.lightdb:
    platform_allow: qemu_x86
    tags: golioth net lightdb goliothd
```

## west.yml
```yaml
manifest:
  projects:
    - name: zephyr
      revision: 7d27f8dd583da5fbcda7167bc0b9ec9aa7d3dad1
      url: https://github.com/zephyrproject-rtos/zephyr
      west-commands: scripts/west-commands.yml
      import:
        name-allowlist:
          - cmsis
          - hal_espressif
          - hal_nordic
          - hal_st
          - hal_stm32
          - mbedtls
          - mcuboot
          - mcumgr
          - net-tools
          - segger
          - tinycrypt
          - zcbor

    - name: qcbor
      revision: 17b5607b8c49b835d22dec3effa97b25c89267b3
      url: https://github.com/golioth/QCBOR.git
      path: modules/lib/qcbor

  self:
    path: modules/lib/golioth
    west-commands: scripts/west-commands.yml
```
