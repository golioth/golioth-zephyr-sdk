## Kconfig
```kconfig
# Kconfig - application configuration options

# Copyright (c) 2021-2023 Golioth, Inc.
# SPDX-License-Identifier: Apache-2.0

menu "Golioth options"

rsource "samples/common/Kconfig.defconfig"

rsource "logging/Kconfig"
rsource "net/Kconfig"

config GOLIOTH_COMPAT_INIT
	bool "Enable SYS_INIT() compatible macro"
	default y if ZEPHYR_NRF_MODULE

rsource "samples/common/Kconfig"

endmenu
```

## app_support/wifi/Kconfig
```kconfig
#
# Copyright (C) 2021 Golioth, Inc.
#
# SPDX-License-Identifier: Apache-2.0
#

config GOLIOTH_SAMPLE_WIFI
	bool "WiFi utilities for samples"
	depends on NET_L2_WIFI_MGMT
	help
	  Enable utilities for easy WiFi setup, mainly for use inside samples/.

config GOLIOTH_SAMPLE_WIFI_SETTINGS
	bool "Load SSID and PSK from settigs subsystem"
	default y if GOLIOTH_SYSTEM_SETTINGS
	depends on GOLIOTH_SAMPLE_WIFI
	depends on SETTINGS
	help
	  Load WiFi SSID and PSK from settings subsystem, from 'wifi/ssid' and
	  'wifi/psk' entries.

if (GOLIOTH_SAMPLE_WIFI && !GOLIOTH_SAMPLE_WIFI_SETTINGS) || WIFI_ESP32

config GOLIOTH_SAMPLE_WIFI_SSID
	string "WiFi SSID"
	help
	  WiFi SSID used when connecting to WiFi AP.

config GOLIOTH_SAMPLE_WIFI_PSK
	string "WiFi PSK"
	help
	  WiFi PSK used when connecting to WiFi AP. Leave empty if connecting to
	  unsecure (open) AP.

endif # (GOLIOTH_SAMPLE_WIFI && !GOLIOTH_SAMPLE_WIFI_SETTINGS) || WIFI_ESP32
```

## bootloader/mcuboot_native_sim/Kconfig
```kconfig
# Copyright (c) 2023 Golioth, Inc.
#
# SPDX-License-Identifier: Apache-2.0

mainmenu "MCUboot (Native Simulator fake bootloader)"

config MCUBOOT_NATIVE_SIM_SIGNED_APPLICATION_EXE
	string "Application executable"
	help
	  Path to application executable, which will be invoked by fake MCUboot
	  bootloader.

config BOOT_USE_MBEDTLS
	bool
	default n
	help
	  Use mbedTLS for crypto primitives.

config BOOT_USE_TINYCRYPT
	bool
	default n
	help
	  Use TinyCrypt for crypto primitives.

choice BOOT_SIGNATURE_TYPE
	prompt "Signature type"
	default BOOT_SIGNATURE_TYPE_RSA

config BOOT_SIGNATURE_TYPE_NONE
	bool "No signature; use only hash check"

config BOOT_SIGNATURE_TYPE_RSA
	bool "RSA signatures"
	select BOOT_USE_MBEDTLS

if BOOT_SIGNATURE_TYPE_RSA
config BOOT_SIGNATURE_TYPE_RSA_LEN
	int "RSA signature length"
	range 2048 3072
	default 2048
endif

config BOOT_SIGNATURE_TYPE_ECDSA_P256
	bool "Elliptic curve digital signatures with curve P-256"
	select BOOT_USE_TINYCRYPT

config BOOT_SIGNATURE_TYPE_ED25519
	bool "Edwards curve digital signatures using ed25519"
	select BOOT_USE_TINYCRYPT

endchoice

config BOOT_SIGNATURE_KEY_FILE
	string "PEM key file"
	default "root-ec-p256.pem" if BOOT_SIGNATURE_TYPE_ECDSA_P256
	default "root-ed25519.pem" if BOOT_SIGNATURE_TYPE_ED25519
	default "root-rsa-3072.pem" if BOOT_SIGNATURE_TYPE_RSA && BOOT_SIGNATURE_TYPE_RSA_LEN=3072
	default "root-rsa-2048.pem" if BOOT_SIGNATURE_TYPE_RSA && BOOT_SIGNATURE_TYPE_RSA_LEN=2048
	default ""
	help
	  You can use either absolute or relative path.
	  In case relative path is used, the build system assumes that it starts
	  from the directory where the MCUBoot KConfig configuration file is
	  located. If the key file is not there, the build system uses relative
	  path that starts from the MCUBoot repository root directory.
	  The key file will be parsed by imgtool's getpub command and a .c source
	  with the public key information will be written in a format expected by
	  MCUboot.

source "Kconfig.zephyr"
```

## logging/Kconfig
```kconfig
#
# Copyright (C) 2021 Golioth
#
# SPDX-License-Identifier: Apache-2.0
#

config LOG_BACKEND_GOLIOTH
	bool "Golioth logging backend"
	depends on LOG
	depends on !LOG_IMMEDIATE
	depends on NET_GOLIOTH
	select TINYCBOR
	help
	  Enable sending logs to Golioth cloud.

if LOG_BACKEND_GOLIOTH

config LOG_BACKEND_GOLIOTH_MAX_PACKET_SIZE
	int "Maximum packet size"
	default 512
	help
	  Specified maximum buffer size used for sending log entry to Golioth
	  cloud.

endif # LOG_BACKEND_GOLIOTH
```

## mgmt/mcumgr/Kconfig
```kconfig
if MCUMGR

config MCUMGR_CMD_CFG_MGMT
	bool "Enable mcumgr handlers for config management"
	help
	  Enables mcumgr handlers for config management.

if MCUMGR_CMD_CFG_MGMT

config MCUMGR_CMD_CFG_MGMT_KEY_MAX_LEN
	int "Maximum key length"
	default 64
	help
	  Defines maximum supported key length of configuration entry.

config MCUMGR_CMD_CFG_MGMT_VAL_MAX_LEN
	int "Maximum value length"
	default 64
	help
	  Defines maximum supported value length of configuration entry.

endif # MCUMGR_CMD_CFG_MGMT

endif # MCUMGR
```

## net/golioth/Kconfig
```kconfig
#
# Copyright (C) 2021 Golioth, Inc.
#
# SPDX-License-Identifier: Apache-2.0
#

config GOLIOTH
	bool "Golioth"
	depends on NETWORKING
	select COAP
	select MBEDTLS
	select MBEDTLS_DTLS
	select MBEDTLS_CIPHER_GCM_ENABLED if MBEDTLS_BUILTIN
	select NET_SOCKETS
	select NET_UDP
	imply DNS_RESOLVER if NET_NATIVE
	imply NET_SOCKETS_SOCKOPT_TLS
	imply NET_SOCKETS_ENABLE_DTLS
	help
	  Enable library for communication with Golioth cloud.

if GOLIOTH

module = GOLIOTH
module-str = golioth
source "subsys/logging/Kconfig.template.log_config"

choice GOLIOTH_AUTH_METHOD
	prompt "Authentication method support"

config GOLIOTH_AUTH_METHOD_PSK
	bool "PSK-ID / PSK only"
	imply GOLIOTH_AUTH_PSK_MBEDTLS_DEPS
	help
	  Only PSK based authentication will be supported.

config GOLIOTH_AUTH_METHOD_CERT
	bool "Certificate based only"
	imply GOLIOTH_AUTH_CERT_MBEDTLS_DEPS
	help
	  Only certificate based authentication will be supported.

endchoice

config GOLIOTH_AUTH_PSK_MBEDTLS_DEPS
	bool "mbedTLS dependencies for PSK auth"
	depends on MBEDTLS_BUILTIN
	select MBEDTLS_KEY_EXCHANGE_PSK_ENABLED
	help
	  Select mbedTLS dependencies for PSK based authentication.

	  This is a convenience option when using mbedTLS as a library to make
	  (D)TLS connection with Golioth cloud.

config GOLIOTH_AUTH_CERT_MBEDTLS_DEPS
	bool "mbedTLS dependencies for certificate based auth"
	depends on MBEDTLS_BUILTIN
	# At least one ECP needs to be selected. This was chosen arbitrarily.
	imply MBEDTLS_ECP_DP_SECP256R1_ENABLED if MBEDTLS_BUILTIN
	select MBEDTLS_KEY_EXCHANGE_ECDHE_ECDSA_ENABLED if MBEDTLS_BUILTIN
	help
	  Select mbedTLS dependencies for certificate based authentication.

	  This is a convenience option when using mbedTLS as a library to make
	  (D)TLS connection with Golioth cloud.

config GOLIOTH_HOSTNAME_VERIFICATION
	bool "Hostname verification"
	default y if GOLIOTH_AUTH_METHOD_CERT
	help
	  Enable hostname verification on (D)TLS layer.

config GOLIOTH_CIPHERSUITES
	string "Ciphersuites"
	# Select single PSK ciphersuite (following ciphersuite preference in mbedTLS)
	default "TLS_PSK_WITH_AES_128_GCM_SHA256" if (GOLIOTH_AUTH_METHOD_PSK && MBEDTLS_BUILTIN && MBEDTLS_CIPHER_GCM_ENABLED)
	default "TLS_PSK_WITH_AES_128_CCM" if (GOLIOTH_AUTH_METHOD_PSK && MBEDTLS_BUILTIN && MBEDTLS_CIPHER_CCM_ENABLED)
	default "TLS_PSK_WITH_AES_128_CBC_SHA256" if (GOLIOTH_AUTH_METHOD_PSK && MBEDTLS_BUILTIN && MBEDTLS_CIPHER_MODE_CBC_ENABLED)
	# Same, but for NCS flavour of mbedTLS
	default "TLS_PSK_WITH_AES_128_GCM_SHA256" if (GOLIOTH_AUTH_METHOD_PSK && ZEPHYR_NRF_MODULE && MBEDTLS_TLS_LIBRARY && MBEDTLS_GCM_C)
	default "TLS_PSK_WITH_AES_128_CCM" if (GOLIOTH_AUTH_METHOD_PSK && ZEPHYR_NRF_MODULE && MBEDTLS_TLS_LIBRARY && MBEDTLS_CCM_C)
	default "TLS_PSK_WITH_AES_128_CBC_SHA256" if (GOLIOTH_AUTH_METHOD_PSK && ZEPHYR_NRF_MODULE && MBEDTLS_TLS_LIBRARY && MBEDTLS_CIPHER_MODE_CBC)
	# Select all supported PSK ciphersuites if not using MBEDTLS_BUILTIN
	default "TLS_PSK_WITH_AES_128_GCM_SHA256 TLS_PSK_WITH_AES_128_CCM TLS_PSK_WITH_AES_128_CBC_SHA256 TLS_PSK_WITH_AES_128_CCM_8" if GOLIOTH_AUTH_METHOD_PSK
	# Select single cert-based ciphersuite (following ciphersuite preference in mbedTLS)
	default "TLS_ECDHE_ECDSA_WITH_AES_128_GCM_SHA256" if (GOLIOTH_AUTH_METHOD_CERT && MBEDTLS_BUILTIN && MBEDTLS_CIPHER_GCM_ENABLED)
	default "TLS_ECDHE_ECDSA_WITH_AES_128_CCM" if (GOLIOTH_AUTH_METHOD_CERT && MBEDTLS_BUILTIN && MBEDTLS_CIPHER_CCM_ENABLED)
	# Same, but for NCS flavour of mbedTLS
	default "TLS_ECDHE_ECDSA_WITH_AES_128_GCM_SHA256" if (GOLIOTH_AUTH_METHOD_CERT && ZEPHYR_NRF_MODULE && MBEDTLS_TLS_LIBRARY && MBEDTLS_GCM_C)
	default "TLS_ECDHE_ECDSA_WITH_AES_128_CCM" if (GOLIOTH_AUTH_METHOD_CERT && ZEPHYR_NRF_MODULE && MBEDTLS_TLS_LIBRARY && MBEDTLS_CCM_C)
	# Select all supported cert-based ciphersuites if not using MBEDTLS_BUILTIN
	default "TLS_ECDHE_ECDSA_WITH_AES_128_GCM_SHA256 TLS_ECDHE_ECDSA_WITH_AES_128_CCM TLS_ECDHE_ECDSA_WITH_AES_128_CCM_8" if GOLIOTH_AUTH_METHOD_CERT
	help
	  Ciphersuite list used during (D)TLS handshakes. Default value contains currently supported
	  ciphersuites by Golioth server.

	  Use string representations of ciphersuites as defined by IANA in:
	  https://www.iana.org/assignments/tls-parameters/tls-parameters.xhtml

	  Select single ciphersuite to reduce data exchanged during (D)TLS handshake, due to reduced
	  ciphersuite list in Client Hello message.

	  Make sure that credentials (e.g. using Zephyr TLS credentials subsystem) are configured
	  for each ciphersuite (e.g. PSKs for PSK-based ciphersuites or certificates for
	  certificate-based ciphersuites) that is negotiated.

	  If empty, then underlying TLS implementation (e.g. mbedTLS library) decides which
	  ciphersuites to use. Relying on that is not recommended!

config GOLIOTH_COAP_MAX_OPTIONS
	int "Maximum CoAP options supported"
	default 16
	help
	  Maximum CoAP options supported by Golioth client.

config GOLIOTH_FW
	bool "Firmware management"
	select QCBOR
	help
	  Enable Golioth firmware management, which allows to ask for newest
	  desired firmware and issue firmware download process.

config GOLIOTH_RPC
	bool "Remote Procedure Call"
	select QCBOR
	help
	  Enable Golioth Remote Procedure Call feature.

config GOLIOTH_RPC_MAX_NUM_METHODS
	int "Maximum number of registered Golioth RPC methods"
	depends on GOLIOTH_RPC
	default 8
	help
	  Maximum number of Golioth Remote Procedure Call methods that can
	  be registered.

config GOLIOTH_SETTINGS
	bool "Settings cloud service"
	select QCBOR
	help
	  Enable Golioth Settings feature. Not to be confused
	  with Zephyr's own Settings subsystem.

config GOLIOTH_FW_PACKAGE_NAME_MAX_LEN
	int "Maximum length of package name"
	default 32
	help
	  Defines maximum supported firmware package name.

config GOLIOTH_SYSTEM_CLIENT
	bool "System client"
	select EVENTFD
	help
	  Enable Golioth system client, which will configure client connection
	  and be responsible for reconnecting in case of networking issues.

if GOLIOTH_SYSTEM_CLIENT

config GOLIOTH_SYSTEM_CLIENT_CREDENTIALS_TAG
	int "TLS credentials secure tag"
	default 515765868
	help
	  Secure tag, which is a reference to TLS credential. This value is
	  configured on created (D)TLS socket in order reference credentials
	  used during connection handshake.

	  See 'sec_tag_t' typedef in Zephyr for details.

config GOLIOTH_SYSTEM_CLIENT_STACK_SIZE
	int "Stack size"
	default 3072
	help
	  Defines system client thread stack size.

config GOLIOTH_SYSTEM_CLIENT_THREAD_PRIORITY
	int "Thread priority"
	default 14
	help
	  Priority at which the Golioth client system thread runs.

config GOLIOTH_SYSTEM_SERVER_HOST
	string "Server Host"
	default "coap.golioth.io" if ((NET_NATIVE && NET_IPV4 && DNS_RESOLVER) || NET_SOCKETS_OFFLOAD)
	default NET_CONFIG_PEER_IPV4_ADDR if (NET_CONFIG_SETTINGS && NET_IPV4)
	default NET_CONFIG_PEER_IPV6_ADDR if (NET_CONFIG_SETTINGS && NET_IPV6)
	help
	  Defines hostname or IP address of Golioth server.

config GOLIOTH_SYSTEM_SERVER_PORT
	int "Server Port"
	default 5684
	help
	  Defines port number of Golioth server.

if GOLIOTH_AUTH_METHOD_PSK

config GOLIOTH_SYSTEM_CLIENT_PSK_ID
	string "PSK ID"
	depends on !GOLIOTH_SYSTEM_SETTINGS
	help
	  Defines PSK ID used during DTLS handshake with Golioth server.

config GOLIOTH_SYSTEM_CLIENT_PSK
	string "PSK"
	depends on !GOLIOTH_SYSTEM_SETTINGS
	help
	  Defines PSK used during DTLS handshake with Golioth server.

endif # GOLIOTH_AUTH_METHOD_PSK

if GOLIOTH_AUTH_METHOD_CERT

config GOLIOTH_SYSTEM_CLIENT_CA_PATH
	string "CA certificate path"
	default "ca.der"
	help
	  Path to CA certificate used for verifying server certificate.

	  Must be in DER (binary) format.

	  Absolute path or relative to application root directory (APPLICATION_SOURCE_DIR).

config GOLIOTH_SYSTEM_CLIENT_CRT_PATH
	string "Public certificate path"
	help
	  Path to client's public certificate.

	  Must be in DER (binary) format.

config GOLIOTH_SYSTEM_CLIENT_KEY_PATH
	string "Private key path"
	help
	  Path to client's private key.

	  Must be in DER (binary) format.

endif # GOLIOTH_AUTH_METHOD_CERT

module = GOLIOTH_SYSTEM_CLIENT
module-str = Log level for Golioth system client
module-help = Sets log level for Golioth system client.
source "subsys/logging/Kconfig.template.log_config"

config GOLIOTH_SYSTEM_CLIENT_INIT_PRIORITY
	int "Initialization priority"
	default APPLICATION_INIT_PRIORITY
	help
	  Initialization priority of Golioth system client.

config GOLIOTH_SYSTEM_CLIENT_PING_INTERVAL_SEC
	int "Ping interval (seconds)"
	default 9
	help
	  Periodic interval between consecutive ping messages being sent to
	  Golioth.

config GOLIOTH_SYSTEM_CLIENT_RX_TIMEOUT_SEC
	int "Receive timeout (seconds)"
	default 30
	help
	  Receive timeout, after which connection will be reestablished.

config GOLIOTH_SYSTEM_CLIENT_RX_BUF_SIZE
	int "Receive buffer size"
	default 1280
	help
	  Size of receive buffer, which is used for reading data from network
	  socket.

config GOLIOTH_SYSTEM_SETTINGS
	bool "Load credentials from persistent settings"
	depends on SETTINGS
	default y
	help
	  When selected, Golioth credentials will be loaded from settings
	  subsystem.

endif # GOLIOTH_SYSTEM_CLIENT

endif # GOLIOTH
```

## net/sockets/Kconfig
```kconfig
#
# Copyright (C) 2022-2023 Golioth, Inc.
#
# SPDX-License-Identifier: Apache-2.0
#

config NET_SOCKETS_OFFLOAD_POLL_WRAPPER
	bool "Socket offload poll() wrapper"
	default y if NRF_MODEM_LIB
	depends on NET_SOCKETS_OFFLOAD
	help
	  Wrapper around offloaded Zephyr sockets, which utilizes a dedicated
	  thread to execute interruptible poll() system call.

	  Enable when communicating with Golioth over offloaded sockets, which
	  return -EXDEV from ioctl(fd, ZFD_IOCTL_POLL_OFFLOAD, ...) and instead
	  implement ioctl(fd, ZFD_IOCTL_POLL_OFFLOAD, ...) system call.

if NET_SOCKETS_OFFLOAD_POLL_WRAPPER

config NET_SOCKETS_OFFLOAD_POLL_WRAPPER_SOCKET_PRIORITY
	int "Socket processing priority"
	default 10
	help
	  Processing priority for sockets implementation. This value should be
	  lower than offloaded sockets priority, which should be wrapped.

	  See NET_SOCKETS_PRIORITY_DEFAULT help for details.

config NET_SOCKETS_OFFLOAD_POLL_WRAPPER_THREAD_STACK_SIZE
	int "Stack size of thread calling poll()"
	default 1024
	help
	  Defines stack size of background thread calling poll() on offloaded
	  socket.

config NET_SOCKETS_OFFLOAD_POLL_WRAPPER_THREAD_PRIORITY
	int "Priority of thread calling poll()"
	default -2 if !PREEMPT_ENABLED
	default 0
	help
	  Priority of helper thread calling poll().

config NET_SOCKETS_OFFLOAD_POLL_WRAPPER_CONTEXT_MAX
	int "Maximum number of dispatcher sockets created"
	default POSIX_MAX_FDS
	help
	  Maximum number of offloaded sockets with poll() executed in dedicated
	  thread. This allocates and creates threads for each of those. Note
	  that all sockets that use this capability at any time count into this
	  limit, as there is no garbage collection or reusing of unused wrapper
	  threads.

endif # NET_SOCKETS_OFFLOAD_POLL_WRAPPER
```

## nrf/applications/asset_tracker_v2/boards/circuitdojo_feather_nrf9160ns.conf
```kconfig
# Initialize LIS2DH12TR, so that it consumes less power than with default
# settings.
CONFIG_I2C=y
CONFIG_SENSOR=y
CONFIG_LIS2DH=y
CONFIG_LIS2DH_ODR_1=y

CONFIG_NRF9160_GPS_ANTENNA_EXTERNAL=y
CONFIG_NRF9160_GPS_SET_COEX0=y
CONFIG_NRF9160_GPS_COEX0_STRING="AT\%XCOEX0=1,1,1565,1586"
```
