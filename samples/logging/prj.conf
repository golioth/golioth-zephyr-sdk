## Kconfig
```
# Copyright (c) 2021 Golioth, Inc.
# SPDX-License-Identifier: Apache-2.0

mainmenu "Golioth Hello application options"

config GOLIOTH_SERVER_IP_ADDR
	string "Server IP Address"
	default "104.197.107.212" if NET_IPV4
	default NET_CONFIG_PEER_IPV6_ADDR if (NET_CONFIG_SETTINGS && NET_IPV6)
	help
	  Defines IPv4 address of Golioth server.

config GOLIOTH_SERVER_PORT
	int "Server Port"
	default 5684 if NET_SOCKETS_SOCKOPT_TLS
	default 5683
	help
	  Defines port number of Golioth server.

config GOLIOTH_SERVER_DTLS_PSK_ID
	string "PSK ID"
	help
	  Defines PSK ID used during DTLS handshake.

config GOLIOTH_SERVER_DTLS_PSK
	string "PSK"
	help
	  Defines PSK ID used during DTLS handshake.

source "Kconfig.zephyr"
```

## sample.yaml
```
sample:
  description: System logging to Golioth server
  name: logging
common:
  harness: pytest
  tags: golioth logger socket goliothd
  timeout: 180
tests:
  sample.golioth.logging:
    platform_allow: >
      esp32_devkitc_wroom
      mimxrt1060_evkb
      nrf52840dk_nrf52840
      nrf9160dk_nrf9160_ns
      qemu_x86
```

## prj.conf
```kconfig
CONFIG_GOLIOTH_SAMPLES_COMMON=y

# Application
CONFIG_LOG_BACKEND_GOLIOTH=y
```

## boards/blackpill_f411ce.conf
```kconfig
# Kernel options
CONFIG_ENTROPY_GENERATOR=y
CONFIG_TEST_RANDOM_GENERATOR=y

# Ethernet with Wiznet W5500 module
CONFIG_SPI=y
CONFIG_ETH_W5500=y
CONFIG_ETH_W5500_TIMEOUT=1000
CONFIG_NET_L2_ETHERNET=y
CONFIG_NET_MGMT=y
CONFIG_NET_DHCPV4=y
```

## boards/mimxrt1060_evkb.conf
```kconfig
CONFIG_GOLIOTH_SAMPLE_DHCP_START=y
CONFIG_NET_L2_ETHERNET=y
CONFIG_NET_MGMT=y
CONFIG_NET_DHCPV4=y
```

## boards/nrf9160dk_nrf9160_ns.conf
```kconfig
# General config
CONFIG_HEAP_MEM_POOL_SIZE=4096
CONFIG_NEWLIB_LIBC=y

# Networking
CONFIG_NET_NATIVE=n
CONFIG_NET_SOCKETS_OFFLOAD=y

# Increase native TLS socket implementation, so that it is chosen instead of
# offloaded nRF91 sockets
CONFIG_NET_SOCKETS_TLS_PRIORITY=35

# LTE link control
CONFIG_LTE_LINK_CONTROL=y
CONFIG_LTE_AUTO_INIT_AND_CONNECT=y

# Modem library
CONFIG_NRF_MODEM_LIB=y

# Enable offloaded sockets wrapper, which makes poll() behave similarly as with native
# (non-offloaded) Zephyr sockets.
CONFIG_NET_SOCKETS_OFFLOAD_POLL_WRAPPER=y

# Use NCS fork of mbedTLS, as Zephyr built-in mbedTLS integration (CONFIG_MBEDTLS_BUILTIN) is in
# conflict with CONFIG_NRF_SECURITY
CONFIG_MBEDTLS_TLS_LIBRARY=y
CONFIG_MBEDTLS_SSL_PROTO_DTLS=y
CONFIG_MBEDTLS_GCM_C=y
# ... and disable options y-selected by NCS for no good reason
CONFIG_MBEDTLS_KEY_EXCHANGE_DHE_PSK_ENABLED=n
CONFIG_MBEDTLS_KEY_EXCHANGE_DHE_RSA_ENABLED=n
# ... also increase heap size to "high enough to make it work"
CONFIG_MBEDTLS_HEAP_SIZE=49152
```

## boards/thingy91_nrf9160_ns.conf
```kconfig
# General config
CONFIG_HEAP_MEM_POOL_SIZE=4096
CONFIG_NEWLIB_LIBC=y

# Networking
CONFIG_NET_NATIVE=n
CONFIG_NET_SOCKETS_OFFLOAD=y

# Use Zephyr mbedTLS, as there was no success so far with using offloaded TLS in
# modem library.
CONFIG_NET_SOCKETS_OFFLOAD_TLS=n

# LTE link control
CONFIG_LTE_LINK_CONTROL=y
CONFIG_LTE_AUTO_INIT_AND_CONNECT=y

# Modem library
CONFIG_NRF_MODEM_LIB=y

# Offloaded poll() does not support external events like eventfd, so use timeout
# in poll() instead.
CONFIG_GOLIOTH_SYSTEM_CLIENT_TIMEOUT_USING_POLL=y
```

## src/main.c
```c
/*
 * Copyright (c) 2021 Golioth, Inc.
 *
 * SPDX-License-Identifier: Apache-2.0
 */

#include <zephyr/logging/log.h>
LOG_MODULE_REGISTER(golioth_logging, LOG_LEVEL_DBG);

#include <samples/common/net_connect.h>
#include <net/golioth/system_client.h>
#include <zephyr/net/coap.h>

static struct golioth_client *client = GOLIOTH_SYSTEM_CLIENT_GET();

static K_SEM_DEFINE(connected, 0, 1);

static void golioth_on_connect(struct golioth_client *client)
{
	k_sem_give(&connected);
}

static void func_1(int counter)
{
	LOG_DBG("Log 1: %d", counter);
}

static void func_2(int counter)
{
	LOG_DBG("Log 2: %d", counter);
}

int main(void)
{
	int counter = 0;

	LOG_DBG("Start Logging sample");

	net_connect();

	client->on_connect = golioth_on_connect;
	golioth_system_client_start();

	k_sem_take(&connected, K_FOREVER);

	while (true) {
		LOG_DBG("Debug info! %d", counter);
		func_1(counter);
		func_2(counter);
		LOG_WRN("Warn: %d", counter);
		LOG_ERR("Err: %d", counter);
		LOG_HEXDUMP_INF(&(uint32_t){sys_cpu_to_le32(counter)}, 4, "Counter hexdump");

		counter++;

		k_sleep(K_SECONDS(5));
	}

	return 0;
}
```
