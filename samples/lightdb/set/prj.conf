## CMakeLists.txt
```
# SPDX-License-Identifier: Apache-2.0

cmake_minimum_required(VERSION 3.20.0)

set(SNIPPET golioth-sample)

find_package(Zephyr REQUIRED HINTS $ENV{ZEPHYR_BASE})
project(lightdb)

target_sources(app PRIVATE src/main.c)
```

## sample.yaml
```
sample:
  description: Use LightDB set
  name: lightdb-set
common:
  harness: pytest
  tags: golioth lightdb socket goliothd
  timeout: 180
tests:
  sample.golioth.lightdb_set:
    platform_allow: >
      esp32_devkitc_wroom
      mimxrt1060_evkb
      nrf52840dk_nrf52840
      nrf9160dk_nrf9160_ns
      qemu_x86
```

## prj.conf
```kconfig
CONFIG_GOLIOTH_SAMPLES_COMMON=y

# Logging
CONFIG_NET_LOG=y

# Network Shell
CONFIG_NET_SHELL=y

# Application
CONFIG_MINIMAL_LIBC_MALLOC_ARENA_SIZE=2048
```

## boards/nrf9160dk_nrf9160_ns.conf
```kconfig
# General config
CONFIG_HEAP_MEM_POOL_SIZE=4096
CONFIG_NEWLIB_LIBC=y

# Networking
CONFIG_NET_SOCKETS_OFFLOAD=y
CONFIG_NET_IPV6=y
CONFIG_NET_IPV6_NBR_CACHE=n
CONFIG_NET_IPV6_MLD=n

# Increase native TLS socket implementation, so that it is chosen instead of
# offloaded nRF91 sockets
CONFIG_NET_SOCKETS_TLS_PRIORITY=35

# Modem library
CONFIG_NRF_MODEM_LIB=y
CONFIG_NRF_MODEM_LIB_ON_FAULT_APPLICATION_SPECIFIC=y

# LTE connectivity with network connection manager
CONFIG_LTE_CONNECTIVITY=y
CONFIG_NET_CONNECTION_MANAGER=y
CONFIG_NET_CONNECTION_MANAGER_MONITOR_STACK_SIZE=1024

# Increased sysworkq size, due to LTE connectivity
CONFIG_SYSTEM_WORKQUEUE_STACK_SIZE=2048

# Disable options y-selected by NCS for no good reason
CONFIG_MBEDTLS_KEY_EXCHANGE_DHE_PSK_ENABLED=n
CONFIG_MBEDTLS_KEY_EXCHANGE_DHE_RSA_ENABLED=n
```

## boards/qemu_x86.conf
```kconfig
# Kernel options
CONFIG_ENTROPY_GENERATOR=y
CONFIG_TEST_RANDOM_GENERATOR=y

# Static networking
CONFIG_NET_CONFIG_LOG_LEVEL_DBG=y
CONFIG_NET_CONFIG_SETTINGS=y
CONFIG_NET_CONFIG_NEED_IPV4=y
CONFIG_NET_CONFIG_MY_IPV4_ADDR="192.0.2.1"
CONFIG_NET_CONFIG_MY_IPV4_GW="192.0.2.2"
CONFIG_NET_CONFIG_PEER_IPV4_ADDR="192.0.2.2"

# QEMU requires FPU to handle any floating point operations
CONFIG_FPU=y
```

## src/main.c
```c
/*
 * Copyright (c) 2021-2022 Golioth, Inc.
 *
 * SPDX-License-Identifier: Apache-2.0
 */

#include <zephyr/logging/log.h>
LOG_MODULE_REGISTER(golioth_lightdb, LOG_LEVEL_DBG);

#include <net/golioth/system_client.h>
#include <samples/common/net_connect.h>

#include <stdlib.h>

static struct golioth_client *client = GOLIOTH_SYSTEM_CLIENT_GET();

static K_SEM_DEFINE(connected, 0, 1);

static void golioth_on_connect(struct golioth_client *client)
{
	k_sem_give(&connected);
}

static int counter_set_handler(struct golioth_req_rsp *rsp)
{
	if (rsp->err) {
		LOG_WRN("Failed to set counter: %d", rsp->err);
		return rsp->err;
	}

	LOG_DBG("Counter successfully set");

	return 0;
}

static void counter_set_async(int counter)
{
	char sbuf[sizeof("4294967295")];
	int err;

	snprintk(sbuf, sizeof(sbuf), "%d", counter);
	sbuf[sizeof(sbuf) - 1] = '\0';

	err = golioth_lightdb_set_cb(client, "counter",
				     GOLIOTH_CONTENT_FORMAT_APP_JSON,
				     sbuf, strlen(sbuf),
				     counter_set_handler, NULL);
	if (err) {
		LOG_WRN("Failed to set counter: %d", err);
		return;
	}
}

static void counter_set_sync(int counter)
{
	char sbuf[sizeof("4294967295")];
	int err;

	snprintk(sbuf, sizeof(sbuf), "%d", counter);
	sbuf[sizeof(sbuf) - 1] = '\0';

	err = golioth_lightdb_set(client, "counter",
				  GOLIOTH_CONTENT_FORMAT_APP_JSON,
				  sbuf, strlen(sbuf));
	if (err) {
		LOG_WRN("Failed to set counter: %d", err);
		return;
	}

	LOG_DBG("Counter successfully set");
}

int main(void)
{
	int counter = 0;

	LOG_DBG("Start LightDB set sample");

	net_connect();

	client->on_connect = golioth_on_connect;
	golioth_system_client_start();

	k_sem_take(&connected, K_FOREVER);

	while (true) {
		LOG_DBG("Setting counter to %d", counter);

		LOG_DBG("Before request (async)");
		counter_set_async(counter);
		LOG_DBG("After request (async)");

		counter++;
		k_sleep(K_SECONDS(5));

		LOG_DBG("Setting counter to %d", counter);

		LOG_DBG("Before request (sync)");
		counter_set_sync(counter);
		LOG_DBG("After request (sync)");

		counter++;
		k_sleep(K_SECONDS(5));
	}

	return 0;
}
```
