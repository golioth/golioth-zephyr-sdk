## sample.yaml
```
sample:
  description: Use LightDB get
  name: lightdb-get
common:
  harness: pytest
  tags: golioth lightdb socket goliothd
  timeout: 180
tests:
  sample.golioth.lightdb_get:
    platform_allow: >
      esp32_devkitc_wroom
      mimxrt1060_evkb
      nrf52840dk_nrf52840
      nrf9160dk_nrf9160_ns
      qemu_x86
    extra_configs:
      - CONFIG_LOG_BACKEND_GOLIOTH=y
```

## prj.conf
```kconfig
CONFIG_GOLIOTH_SAMPLES_COMMON=y

# Generic networking options
CONFIG_NETWORKING=y
CONFIG_NET_IPV4=y
CONFIG_NET_IPV6=n

# Logging
CONFIG_NET_LOG=y

# Network Shell
CONFIG_NET_SHELL=y

# Application
CONFIG_MAIN_STACK_SIZE=4096

CONFIG_GOLIOTH=y
CONFIG_GOLIOTH_SYSTEM_CLIENT=y

CONFIG_MINIMAL_LIBC_MALLOC_ARENA_SIZE=2048
```

## boards/nrf9160dk_nrf9160_ns.conf
```kconfig
# General config
CONFIG_HEAP_MEM_POOL_SIZE=4096
CONFIG_NEWLIB_LIBC=y

# Networking
CONFIG_NET_NATIVE=n
CONFIG_NET_SOCKETS_OFFLOAD=y

# Use Zephyr mbedTLS, as there was no success so far with using offloaded TLS in
# modem library.
CONFIG_NET_SOCKETS_OFFLOAD_TLS=n

# Increase native TLS socket implementation, so that it is chosen instead of
# offloaded nRF91 sockets
CONFIG_NET_SOCKETS_TLS_PRIORITY=35

# LTE link control
CONFIG_LTE_LINK_CONTROL=y
CONFIG_LTE_AUTO_INIT_AND_CONNECT=y

# Modem library
CONFIG_NRF_MODEM_LIB=y

# Offloaded poll() does not support external events like eventfd, so use timeout
# in poll() instead.
CONFIG_GOLIOTH_SYSTEM_CLIENT_TIMEOUT_USING_POLL=y

# Conflicts with MBEDTLS_DTLS
CONFIG_BUILD_WITH_TFM=n
```

## src/main.c
```c
/*
 * Copyright (c) 2021-2022 Golioth, Inc.
 *
 * SPDX-License-Identifier: Apache-2.0
 */

#include <zephyr/logging/log.h>
LOG_MODULE_REGISTER(golioth_lightdb, LOG_LEVEL_DBG);

#include <net/golioth/system_client.h>
#include <samples/common/net_connect.h>

#include <stdlib.h>

static struct golioth_client *client = GOLIOTH_SYSTEM_CLIENT_GET();

static K_SEM_DEFINE(connected, 0, 1);

static void golioth_on_connect(struct golioth_client *client)
{
	k_sem_give(&connected);
}

static int counter_handler(struct golioth_req_rsp *rsp)
{
	if (rsp->err) {
		LOG_ERR("Failed to receive counter value: %d", rsp->err);
		return rsp->err;
	}

	LOG_HEXDUMP_INF(rsp->data, rsp->len, "Counter (async)");

	return 0;
}

static void counter_get_async(struct golioth_client *client)
{
	int err;

	err = golioth_lightdb_get_cb(client, "counter",
				     GOLIOTH_CONTENT_FORMAT_APP_JSON,
				     counter_handler, NULL);
	if (err) {
		LOG_WRN("failed to get data from LightDB: %d", err);
	}
}

static void counter_get_sync(struct golioth_client *client)
{
	uint8_t value[128];
	size_t len = sizeof(value);
	int err;

	err = golioth_lightdb_get(client, "counter",
				  GOLIOTH_CONTENT_FORMAT_APP_JSON,
				  value, &len);
	if (err) {
		LOG_WRN("failed to get data from LightDB: %d", err);
	}

	LOG_HEXDUMP_INF(value, len, "Counter (sync)");
}

int main(void)
{
	LOG_DBG("Start LightDB get sample");

	net_connect();

	client->on_connect = golioth_on_connect;
	golioth_system_client_start();

	k_sem_take(&connected, K_FOREVER);

	while (true) {
		LOG_INF("Before request (async)");
		counter_get_async(client);
		LOG_INF("After request (async)");

		k_sleep(K_SECONDS(5));

		LOG_INF("Before request (sync)");
		counter_get_sync(client);
		LOG_INF("After request (sync)");

		k_sleep(K_SECONDS(5));
	}

	return 0;
}
```
