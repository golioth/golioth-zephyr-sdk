## Kconfig
```
# Copyright (c) 2021 Golioth, Inc.
# SPDX-License-Identifier: Apache-2.0

mainmenu "Golioth application options"

if DNS_RESOLVER

config DNS_SERVER_IP_ADDRESSES
	default y

config DNS_SERVER1
	default "1.1.1.1"

endif # DNS_RESOLVER

source "Kconfig.zephyr"
```

## sample.yaml
```
sample:
  description: Use LightDB delete
  name: lightdb-delete
common:
  harness: pytest
  tags: golioth lightdb socket goliothd
  timeout: 180
tests:
  sample.golioth.lightdb_delete:
    platform_allow: >
      esp32
      mimxrt1060_evkb
      nrf52840dk_nrf52840
      nrf9160dk_nrf9160_ns
      qemu_x86
    extra_configs:
      - CONFIG_LOG_BACKEND_GOLIOTH=y
```

## prj.conf
```kconfig
CONFIG_GOLIOTH_SAMPLES_COMMON=y
```

## boards/nrf9160dk_nrf9160_ns.conf
```kconfig
# General config
CONFIG_HEAP_MEM_POOL_SIZE=4096
CONFIG_NEWLIB_LIBC=y

# Networking
CONFIG_NET_NATIVE=n
CONFIG_NET_SOCKETS_OFFLOAD=y

# Increase native TLS socket implementation, so that it is chosen instead of
# offloaded nRF91 sockets
CONFIG_NET_SOCKETS_TLS_PRIORITY=35

# LTE link control
CONFIG_LTE_LINK_CONTROL=y
CONFIG_LTE_AUTO_INIT_AND_CONNECT=y

# Modem library
CONFIG_NRF_MODEM_LIB=y

# Disable options y-selected by NCS for no good reason
CONFIG_MBEDTLS_KEY_EXCHANGE_DHE_PSK_ENABLED=n
CONFIG_MBEDTLS_KEY_EXCHANGE_DHE_RSA_ENABLED=n
```

## src/main.c
```c
/*
 * Copyright (c) 2022 Golioth, Inc.
 *
 * SPDX-License-Identifier: Apache-2.0
 */

#include <zephyr/logging/log.h>
LOG_MODULE_REGISTER(golioth_lightdb, LOG_LEVEL_DBG);

#include <net/golioth/system_client.h>
#include <samples/common/net_connect.h>

#include <stdlib.h>

static struct golioth_client *client = GOLIOTH_SYSTEM_CLIENT_GET();

static K_SEM_DEFINE(connected, 0, 1);

static void golioth_on_connect(struct golioth_client *client)
{
	k_sem_give(&connected);
}

static int counter_handler(struct golioth_req_rsp *rsp)
{
	if (rsp->err) {
		LOG_ERR("Failed to receive counter value: %d", rsp->err);
		return rsp->err;
	}

	LOG_DBG("Counter deleted successfully");

	return 0;
}

static void counter_delete_async(struct golioth_client *client)
{
	int err;

	err = golioth_lightdb_delete_cb(client, "counter",
					counter_handler, NULL);
	if (err) {
		LOG_WRN("failed to delete data from LightDB: %d", err);
	}
}

static void counter_delete_sync(struct golioth_client *client)
{
	int err;

	err = golioth_lightdb_delete(client, "counter");
	if (err) {
		LOG_WRN("failed to delete data from LightDB: %d", err);
	}

	LOG_DBG("Counter deleted successfully");
}

int main(void)
{
	LOG_DBG("Start LightDB delete sample");

	net_connect();

	client->on_connect = golioth_on_connect;
	golioth_system_client_start();

	k_sem_take(&connected, K_FOREVER);

	while (true) {
		LOG_DBG("Before request (async)");
		counter_delete_async(client);
		LOG_DBG("After request (async)");

		k_sleep(K_SECONDS(5));

		LOG_DBG("Before request (sync)");
		counter_delete_sync(client);
		LOG_DBG("After request (sync)");

		k_sleep(K_SECONDS(5));
	}

	return 0;
}
```
