## sample.yaml
```
sample:
  description: Use LightDB observe
  name: lightdb-observe
common:
  harness: pytest
  tags: golioth lightdb socket goliothd
  timeout: 180
tests:
  sample.golioth.lightdb_observe:
    platform_allow: >
      esp32
      mimxrt1060_evkb
      nrf52840dk_nrf52840
      nrf9160dk_nrf9160_ns
      qemu_x86
    extra_configs:
      - CONFIG_LOG_BACKEND_GOLIOTH=y
```

## prj.conf
```kconfig
CONFIG_GOLIOTH_SAMPLES_COMMON=y

# Generic networking options
CONFIG_NETWORKING=y
CONFIG_NET_IPV4=y
CONFIG_NET_IPV6=n

# Logging
CONFIG_NET_LOG=y

# Network Shell
CONFIG_NET_SHELL=y

# Application
CONFIG_MINIMAL_LIBC_MALLOC_ARENA_SIZE=2048
```

## boards/nrf9160dk_nrf9160_ns.conf
```kconfig
# General config
CONFIG_HEAP_MEM_POOL_SIZE=4096
CONFIG_NEWLIB_LIBC=y

# Networking
CONFIG_NET_NATIVE=n
CONFIG_NET_SOCKETS_OFFLOAD=y

# Increase native TLS socket implementation, so that it is chosen instead of
# offloaded nRF91 sockets
CONFIG_NET_SOCKETS_TLS_PRIORITY=35

# LTE link control
CONFIG_LTE_LINK_CONTROL=y
CONFIG_LTE_AUTO_INIT_AND_CONNECT=y

# Modem library
CONFIG_NRF_MODEM_LIB=y

# Offloaded poll() does not support external events like eventfd, so use timeout
# in poll() instead.
CONFIG_GOLIOTH_SYSTEM_CLIENT_TIMEOUT_USING_POLL=y

# Use NCS fork of mbedTLS, as Zephyr built-in mbedTLS integration (CONFIG_MBEDTLS_BUILTIN) is in
# conflict with CONFIG_NRF_SECURITY
CONFIG_MBEDTLS_TLS_LIBRARY=y
CONFIG_MBEDTLS_SSL_PROTO_DTLS=y
CONFIG_MBEDTLS_GCM_C=y
# ... and disable options y-selected by NCS for no good reason
CONFIG_MBEDTLS_KEY_EXCHANGE_DHE_PSK_ENABLED=n
CONFIG_MBEDTLS_KEY_EXCHANGE_DHE_RSA_ENABLED=n
# ... also increase heap size to "high enough to make it work"
CONFIG_MBEDTLS_HEAP_SIZE=49152
```

## src/main.c
```c
/*
 * Copyright (c) 2021-2022 Golioth, Inc.
 *
 * SPDX-License-Identifier: Apache-2.0
 */

#include <zephyr/logging/log.h>
LOG_MODULE_REGISTER(golioth_lightdb, LOG_LEVEL_DBG);

#include <net/golioth/system_client.h>
#include <samples/common/net_connect.h>
#include <zephyr/net/coap.h>

#include <stdlib.h>

static struct golioth_client *client = GOLIOTH_SYSTEM_CLIENT_GET();

/*
 * This function is registered to be called when the data
 * stored at `/counter` changes.
 */
static int counter_handler(struct golioth_req_rsp *rsp)
{
	if (rsp->err) {
		LOG_ERR("Failed to receive counter value: %d", rsp->err);
		return rsp->err;
	}

	LOG_HEXDUMP_INF(rsp->data, rsp->len, "Counter");

	return 0;
}

/*
 * In the `main` function, this function is registered to be
 * called when the device connects to the Golioth server.
 */
static void golioth_on_connect(struct golioth_client *client)
{
	int err;

	/*
	 * Observe the data stored at `/counter` in LightDB.
	 * When that data is updated, the `on_update` callback
	 * will be called.
	 * This will get the value when first called, even if
	 * the value doesn't change.
	 */
	err = golioth_lightdb_observe_cb(client, "counter",
					 GOLIOTH_CONTENT_FORMAT_APP_JSON,
					 counter_handler, NULL);

	if (err) {
		LOG_WRN("failed to observe lightdb path: %d", err);
	}
}

int main(void)
{
	LOG_DBG("Start LightDB observe sample");

	net_connect();

	client->on_connect = golioth_on_connect;
	golioth_system_client_start();

	while (true) {
		k_sleep(K_SECONDS(5));
	}

	return 0;
}
```
