## CMakeLists.txt
```
# SPDX-License-Identifier: Apache-2.0

cmake_minimum_required(VERSION 3.13.1)

find_package(Zephyr REQUIRED HINTS $ENV{ZEPHYR_BASE})
project(example-app)

target_sources(app PRIVATE src/main.c)
```

## Kconfig
```
# Copyright (c) 2021 Golioth, Inc.
# SPDX-License-Identifier: Apache-2.0

mainmenu "Golioth application options"

config GPS_DEVICE_NAME
	string "GPS device name"
	help
		GPS device from which location data will be fetched

source "Kconfig.zephyr"
```

## sample.yaml
```
sample:
  description: Log GPS fix to Golioth server
  name: nrf91-gps
common:
  harness: net
  platform_allow: esp32 circuitdojo_feather_nrf9160ns
  tags: golioth gps asset tracker
tests:
  sample.golioth.nrf91-gps: {}
```

## prj.conf
```kconfig
# Generic networking options
CONFIG_NETWORKING=y
CONFIG_NET_IPV4=y
CONFIG_NET_IPV6=n

# Logging
CONFIG_NET_LOG=y

# Network Shell
CONFIG_NET_SHELL=y

# TLS configuration
CONFIG_MBEDTLS_ENABLE_HEAP=y
CONFIG_MBEDTLS_HEAP_SIZE=8192
CONFIG_MBEDTLS_SSL_MAX_CONTENT_LEN=2048

# Application
CONFIG_MAIN_STACK_SIZE=4096
CONFIG_EVENTFD=y

CONFIG_GOLIOTH=y
CONFIG_GOLIOTH_SYSTEM_CLIENT=y

# CONFIG_TINYCBOR=y
# CONFIG_CBOR_FLOATING_POINT=y

CONFIG_LOG_BACKEND_GOLIOTH=y
CONFIG_LOG_PROCESS_THREAD_STACK_SIZE=2048

CONFIG_GOLIOTH_SYSTEM_CLIENT_PSK_ID="nrf9160-psk-id"    # temporary
CONFIG_GOLIOTH_SYSTEM_CLIENT_PSK="nrf9160-psk"          # temporary

# GPS
CONFIG_NRF9160_GPS=y
CONFIG_NRF9160_GPS_LOG_LEVEL_DBG=y
CONFIG_GPS_DEVICE_NAME="NRF9160_GPS"
CONFIG_NRF9160_GPS_HANDLE_MODEM_CONFIGURATION=y
CONFIG_LTE_NETWORK_MODE_LTE_M_GPS=y
# CONFIG_AGPS=y # Requires SUPL
```

## src/main.c
```c
/*
 * Copyright (c) 2021 Golioth, Inc.
 *
 * SPDX-License-Identifier: Apache-2.0
 */

#include <logging/log.h>
LOG_MODULE_REGISTER(golioth_logging, LOG_LEVEL_DBG);

#include <net/coap.h>
// #include <tinycbor/cbor.h>
// #include <tinycbor/cbor_buf_writer.h>
#include <net/golioth/system_client.h>
#include <net/golioth/wifi.h>
#include <kernel.h>
#include <modem/lte_lc.h>
#include <modem/at_cmd.h>
#include <modem/at_notif.h>
#include <drivers/gps.h>

// static struct golioth_client *client = GOLIOTH_SYSTEM_CLIENT_GET();
static const struct device *gps_device;

// static void print_gps_satellite_stats(nrf_gnss_data_frame_t *gps_data) {
//     uint8_t tracked, in_fix, unhealthy;

//     gps_satellite_stats(gps_data, &tracked, &in_fix, &unhealthy);

//     printk("Tracking: %d, Using: [%d/%d], Unhealthy: [%d/%d]\n", tracked, in_fix, tracked, unhealthy, tracked);
// }

// static void print_gps_fix_data(nrf_gnss_data_frame_t *gps_data)
// {
//     printk("Longitude:  %f\n", gps_data->pvt.longitude);
//     printk("Latitude:   %f\n", gps_data->pvt.latitude);
//     printk("Altitude:   %f\n", gps_data->pvt.altitude);
//     printk("Speed:      %f\n", gps_data->pvt.speed);
//     printk("Heading:    %f\n", gps_data->pvt.heading);
// }

// static void upload_gps_fix_data(nrf_gnss_data_frame_t *gps_data)
// {
//     uint8_t buf[128];
//     struct cbor_buf_writer buf_writer;
//     CborEncoder encoder, map_encoder;
//     CborError cbor_err = CborNoError;
//     int golioth_err;

//     cbor_buf_writer_init(&buf_writer, buf, sizeof(buf));
//     cbor_encoder_init(&encoder, &buf_writer.enc, 0);

//     cbor_err |= cbor_encoder_create_map(&encoder, &map_encoder, 1);

//     cbor_err |= cbor_encode_text_stringz(&map_encoder, "longitude");
//     cbor_err |= cbor_encode_float(&map_encoder, gps_data->pvt.longitude);

//     cbor_err |= cbor_encode_text_stringz(&map_encoder, "latitude");
//     cbor_err |= cbor_encode_float(&map_encoder, gps_data->pvt.latitude);

//     cbor_err |= cbor_encode_text_stringz(&map_encoder, "altitude");
//     cbor_err |= cbor_encode_float(&map_encoder, gps_data->pvt.altitude);

//     cbor_err |= cbor_encode_text_stringz(&map_encoder, "speed");
//     cbor_err |= cbor_encode_float(&map_encoder, gps_data->pvt.speed);

//     cbor_err |= cbor_encode_text_stringz(&map_encoder, "heading");
//     cbor_err |= cbor_encode_float(&map_encoder, gps_data->pvt.heading);

//     cbor_err |= cbor_encoder_close_container(&encoder, &map_encoder);

//     // If any errors other than `CborOutOfMemory` occured, abort.
//     if ((cbor_err & ~(CborNoError | CborErrorOutOfMemory)) != 0) {
//         LOG_ERR("failed to generate gps fix cbor data");
//         return;
//     }

//     if ((cbor_err & CborErrorOutOfMemory) != 0) {
//         LOG_WRN("the buffer is too small to cbor encode the GPS fix.");
//         return;
//     }

//     // Push the GPS fix data to a LightDB stream called `gps`.
//     golioth_err = golioth_lightdb_set(
//         client,
//         GOLIOTH_LIGHTDB_STREAM_PATH("gps"),
//         COAP_CONTENT_FORMAT_APP_CBOR,
//         buf, cbor_buf_writer_buffer_size(&buf_writer, buf)
//     );

//     if (golioth_err) {
//         LOG_ERR("Failed to push GPS fix data to stream: %d", golioth_err);
//     }
// }

void gps_event_handler(const struct device *dev, struct gps_event *event)
{
    switch (event->type) {
        case GPS_EVT_PVT:
            LOG_INF("latitude: %f, longitude: %f", event->pvt.latitude, event->pvt.longitude);
            break;
        default:
            break;
    }
}

static int gps_controller_init(void)
{
    int err;

    gps_device = device_get_binding(CONFIG_GPS_DEVICE_NAME);
    if (gps_device == NULL) {
        LOG_ERR("failed to retrieve GPS device");
        return -ENODEV;
    }

    err = gps_init(gps_device, gps_event_handler);
    if (err) {
        LOG_ERR("failed to initialize GPS device, err: %d", err);
        return err;
    }

    LOG_INF("GPS initialized");

    return err;
}

static void gps_controller_start(void)
{
    int err;

    struct gps_config cfg = {
        .nav_mode = GPS_NAV_MODE_PERIODIC,
        .power_mode = GPS_POWER_MODE_DISABLED,
        .timeout = 360,
        .interval = 360 + 30,
        .priority = true,
    };

    if (gps_device == NULL) {
        LOG_ERR("GPS device is not initialized");
        return;
    }

    LOG_INF("Enabling PSM");

	err = lte_lc_psm_req(true);
	if (err) {
		LOG_ERR("PSM request failed, error: %d", err);
	} else {
		LOG_INF("PSM enabled");
	}

    err = gps_start(gps_device, &cfg);
    if (err) {
        LOG_ERR("failed to start GPS, err: %d", err);
        return;
    }

    LOG_INF("GPS started successfully");
}

void main(void)
{
    LOG_INF("Starting GPS Sample...");

    if (gps_controller_init()) {
        return;
    }

    gps_controller_start();

    // golioth_system_client_start();

    while (true) {
        k_sleep(K_SECONDS(5));
    }
}
```

## src/gps.c
```c
/*
 * Copyright (c) 2021 Golioth, Inc.
 * Copyright (c) 2019 Nordic Semiconductor ASA
 *
 * SPDX-License-Identifier: LicenseRef-Nordic-5-Clause
 */

#include <net/socket.h>
#include <modem/at_cmd.h>
#include <modem/at_notif.h>

#include "gps.h"

#define AT_XSYSTEMMODE      "AT\%XSYSTEMMODE=1,0,1,0"
#define AT_ACTIVATE_GPS     "AT+CFUN=31"
#define AT_ACTIVATE_LTE     "AT+CFUN=21"
#define AT_DEACTIVATE_LTE   "AT+CFUN=20"

#define GNSS_INIT_AND_START 1
#define GNSS_STOP           2
#define GNSS_RESTART        3

#define AT_CMD_SIZE(x) (sizeof(x) - 1)

#ifdef CONFIG_BOARD_NRF9160DK_NRF9160NS
#define AT_MAGPIO      "AT\%XMAGPIO=1,0,0,1,1,1574,1577"
#ifdef CONFIG_GPS_SAMPLE_ANTENNA_ONBOARD
#define AT_COEX0       "AT\%XCOEX0=1,1,1565,1586"
#elif CONFIG_GPS_SAMPLE_ANTENNA_EXTERNAL
#define AT_COEX0       "AT\%XCOEX0"
#endif
#endif /* CONFIG_BOARD_NRF9160DK_NRF9160NS */

#ifdef CONFIG_BOARD_THINGY91_NRF9160NS
#define AT_MAGPIO      "AT\%XMAGPIO=1,1,1,7,1,746,803,2,698,748,2,1710,2200," \
			"3,824,894,4,880,960,5,791,849,7,1565,1586"
#ifdef CONFIG_GPS_SAMPLE_ANTENNA_ONBOARD
#define AT_COEX0       "AT\%XCOEX0=1,1,1565,1586"
#elif CONFIG_GPS_SAMPLE_ANTENNA_EXTERNAL
#define AT_COEX0       "AT\%XCOEX0"
#endif
#endif /* CONFIG_BOARD_THINGY91_NRF9160NS */

#ifdef CONFIG_BOARD_CIRCUITDOJO_FEATHER_NRF9160NS
#define AT_COEX0 		"AT%XCOEX0=1,1,1565,1586"
#endif /* CONFIG_BOARD_CIRCUITDOJO_FEATHER_NRF9160NS */

static int                   gnss_fd;
static char                  nmea_strings[10][NRF_GNSS_NMEA_MAX_LEN];
static uint32_t              nmea_string_cnt;

static bool                  got_fix = false;
static uint64_t              fix_timestamp;
static nrf_gnss_data_frame_t in_progress_pvt = { 0 };

static const char status1[] = "+CEREG: 1";
static const char status2[] = "+CEREG:1";
static const char status3[] = "+CEREG: 5";
static const char status4[] = "+CEREG:5";

K_SEM_DEFINE(lte_ready, 0, 1);

static const char *const at_commands[] = {
	AT_XSYSTEMMODE,
#if defined(CONFIG_BOARD_NRF9160DK_NRF9160NS) || \
	defined(CONFIG_BOARD_THINGY91_NRF9160NS)
	AT_MAGPIO,
	AT_COEX0,
#elif defined(CONFIG_BOARD_CIRCUITDOJO_FEATHER_NRF9160NS) 
	AT_COEX0,
#endif
	AT_ACTIVATE_GPS
};

static int setup_modem(void)
{
    for (int i = 0; i < ARRAY_SIZE(at_commands); i++) {
        int err = at_cmd_write(at_commands[i], NULL, 0, NULL);
        if (err != 0) {
            printk("Failed to write AT command[%d], err: %d\n", i, err);
            return -1;
        }
    }

    return 0;
}

static void wait_for_lte(void *context, const char *response)
{
	if (!memcmp(status1, response, AT_CMD_SIZE(status1)) ||
		!memcmp(status2, response, AT_CMD_SIZE(status2)) ||
		!memcmp(status3, response, AT_CMD_SIZE(status3)) ||
		!memcmp(status4, response, AT_CMD_SIZE(status4))) {
		k_sem_give(&lte_ready);
	}
}

static int activate_lte(bool activate)
{
	if (activate) {
		if (at_cmd_write(AT_ACTIVATE_LTE, NULL, 0, NULL) != 0) {
			return -1;
		}

		at_notif_register_handler(NULL, wait_for_lte);
		if (at_cmd_write("AT+CEREG=2", NULL, 0, NULL) != 0) {
			return -1;
		}

		k_sem_take(&lte_ready, K_FOREVER);

		at_notif_deregister_handler(NULL, wait_for_lte);
		if (at_cmd_write("AT+CEREG=0", NULL, 0, NULL) != 0) {
			return -1;
		}
	} else {
		if (at_cmd_write(AT_DEACTIVATE_LTE, NULL, 0, NULL) != 0) {
			return -1;
		}
	}

	return 0;
}

static int gnss_ctrl(uint32_t ctrl)
{
    int retval;

    nrf_gnss_fix_retry_t    fix_retry    = 0;
    nrf_gnss_fix_interval_t fix_interval = 1;
    nrf_gnss_delete_mask_t	delete_mask  = 0;
    nrf_gnss_nmea_mask_t	nmea_mask    = NRF_GNSS_NMEA_GSV_MASK |
                           NRF_GNSS_NMEA_GSA_MASK |
                           NRF_GNSS_NMEA_GLL_MASK |
                           NRF_GNSS_NMEA_GGA_MASK |
                           NRF_GNSS_NMEA_RMC_MASK;

    if (ctrl == GNSS_INIT_AND_START) {
        gnss_fd = nrf_socket(NRF_AF_LOCAL,
                     NRF_SOCK_DGRAM,
                     NRF_PROTO_GNSS);

        if (gnss_fd >= 0) {
            printk("GPS Socket created\n");
        } else {
            printk("Could not init socket (err: %d)\n", gnss_fd);
            return -1;
        }

        retval = nrf_setsockopt(gnss_fd,
                    NRF_SOL_GNSS,
                    NRF_SO_GNSS_FIX_RETRY,
                    &fix_retry,
                    sizeof(fix_retry));
        if (retval != 0) {
            printk("Failed to set fix retry value\n");
            return -1;
        }

        retval = nrf_setsockopt(gnss_fd,
                    NRF_SOL_GNSS,
                    NRF_SO_GNSS_FIX_INTERVAL,
                    &fix_interval,
                    sizeof(fix_interval));
        if (retval != 0) {
            printk("Failed to set fix interval value\n");
            return -1;
        }

        retval = nrf_setsockopt(gnss_fd,
                    NRF_SOL_GNSS,
                    NRF_SO_GNSS_NMEA_MASK,
                    &nmea_mask,
                    sizeof(nmea_mask));
        if (retval != 0) {
            printk("Failed to set nmea mask\n");
            return -1;
        }
    }

    if ((ctrl == GNSS_INIT_AND_START) ||
        (ctrl == GNSS_RESTART)) {
        retval = nrf_setsockopt(gnss_fd,
                    NRF_SOL_GNSS,
                    NRF_SO_GNSS_START,
                    &delete_mask,
                    sizeof(delete_mask));
        if (retval != 0) {
            printk("Failed to start GPS\n");
            return -1;
        }
    }

    if (ctrl == GNSS_STOP) {
        retval = nrf_setsockopt(gnss_fd,
                    NRF_SOL_GNSS,
                    NRF_SO_GNSS_STOP,
                    &delete_mask,
                    sizeof(delete_mask));
        if (retval != 0) {
            printk("Failed to stop GPS\n");
            return -1;
        }
    }

    return 0;
}

int gps_init(void)
{
    int retval;

    activate_lte(false);

    if (setup_modem() != 0) {
        printk("Failed to initialize modem\n");
        return -1;
    }

    retval = gnss_ctrl(GNSS_INIT_AND_START);

    // activate_lte(true);

    return retval;
}

static int gps_process_data(nrf_gnss_data_frame_t *gps_data)
{
    int retval;

    retval = nrf_recv(gnss_fd,
              &in_progress_pvt,
              sizeof(nrf_gnss_data_frame_t),
              NRF_MSG_DONTWAIT);

    if (retval > 0) {
        switch (in_progress_pvt.data_id) {
            case NRF_GNSS_PVT_DATA_ID:
                memcpy(&in_progress_pvt,
                        gps_data,
                        sizeof(nrf_gnss_data_frame_t));

                nmea_string_cnt = 0;
                got_fix = false;

                if ((in_progress_pvt.pvt.flags &
                    NRF_GNSS_PVT_FLAG_FIX_VALID_BIT)
                    == NRF_GNSS_PVT_FLAG_FIX_VALID_BIT)
                {

                    got_fix = true;
                    fix_timestamp = k_uptime_get();
                }
                break;

            case NRF_GNSS_NMEA_DATA_ID:
                if (nmea_string_cnt < 10) {
                    memcpy(nmea_strings[nmea_string_cnt++],
                        in_progress_pvt.nmea,
                        retval);
                }
                break;

            default:
                break;
        }
    }

    return retval;
}

int gps_get_data(nrf_gnss_data_frame_t *gps_data)
{
    int err;

    while (true) {
        err = gps_process_data(gps_data);
        if (err <= 0) {
            return err;
        }
    }
}

bool gps_has_fix(void)
{
    return got_fix;
}

uint64_t gps_msec_since_last_fix(void)
{
    return k_uptime_get() - fix_timestamp;
}

void gps_satellite_stats(nrf_gnss_data_frame_t *gps_data, uint8_t *tracked, uint8_t* in_fix, uint8_t *unhealthy)
{
    *tracked = 0;
    *in_fix = 0;
    *unhealthy = 0;

    for (int i = 0; i < NRF_GNSS_MAX_SATELLITES; ++i) {
        if ((in_progress_pvt.pvt.sv[i].sv > 0) &&
            (in_progress_pvt.pvt.sv[i].sv < 33))
        {
            (*tracked)++;

            if (in_progress_pvt.pvt.sv[i].flags & NRF_GNSS_SV_FLAG_USED_IN_FIX) {
                (*in_fix)++;
            }

            if (in_progress_pvt.pvt.sv[i].flags & NRF_GNSS_SV_FLAG_UNHEALTHY) {
                (*unhealthy)++;
            }
        }
    }
}
```

## src/gps.h
```c
/*
 * Copyright (c) 2021 Golioth, Inc.
 * Copyright (c) 2019 Nordic Semiconductor ASA
 *
 * SPDX-License-Identifier: LicenseRef-Nordic-5-Clause
 */

#ifndef GPS_H
#define GPS_H

#include <stdbool.h>
#include <nrf_socket.h>

#ifdef __cplusplus
extern "C" {
#endif

int gps_init(void);

int gps_get_data(nrf_gnss_data_frame_t *gps_data);

bool gps_has_fix(void);
uint64_t gps_msec_since_last_fix(void);
void gps_satellite_stats(nrf_gnss_data_frame_t *gps_data, uint8_t *tracked, uint8_t* in_fix, uint8_t *unhealthy);

#ifdef __cplusplus
}
#endif

#endif /* GPS_H */
```
