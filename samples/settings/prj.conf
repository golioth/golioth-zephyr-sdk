## CMakeLists.txt
```
# SPDX-License-Identifier: Apache-2.0

cmake_minimum_required(VERSION 3.20.0)

set(SNIPPET golioth-sample)

find_package(Zephyr REQUIRED HINTS $ENV{ZEPHYR_BASE})
project(settings)

target_sources(app PRIVATE src/main.c)
```

## sample.yaml
```
sample:
  description: >
    Say Hello to Golioth server, with credentials stored in settings subsystem
  name: settings
common:
  harness: net
  platform_allow: >
    esp32_devkitc_wroom
    mimxrt1060_evkb
    nrf52840dk_nrf52840
    nrf9160dk_nrf9160_ns
    qemu_x86
  tags: golioth settings socket
tests:
  sample.golioth.settings: {}
```

## prj.conf
```kconfig
CONFIG_GOLIOTH_SAMPLES_COMMON=y

# Application
CONFIG_LOG_BACKEND_GOLIOTH=y

CONFIG_SYSTEM_WORKQUEUE_STACK_SIZE=4096

CONFIG_GOLIOTH_SETTINGS=y
```

## boards/circuitdojo_feather_nrf9160ns.conf
```kconfig
# General config
CONFIG_HEAP_MEM_POOL_SIZE=4096
CONFIG_NEWLIB_LIBC=y

# Networking
CONFIG_NET_NATIVE=n
CONFIG_NET_SOCKETS_OFFLOAD=y

# Use Zephyr mbedTLS, as there was no success so far with using offloaded TLS in
# modem library.
CONFIG_NET_SOCKETS_OFFLOAD_TLS=n

# LTE link control
CONFIG_LTE_LINK_CONTROL=y
CONFIG_LTE_AUTO_INIT_AND_CONNECT=y

# Modem library
CONFIG_NRF_MODEM_LIB=y

# Workaround for https://devzone.nordicsemi.com/f/nordic-q-a/75839/nrf-samples-nrf9160-mqtt_simple-bus-fault
CONFIG_FPU=y

# Offloaded poll() does not support external events like eventfd, so use timeout
# in poll() instead.
CONFIG_GOLIOTH_SYSTEM_CLIENT_TIMEOUT_USING_POLL=y
```

## boards/esp32.conf
```kconfig
CONFIG_WIFI=y
CONFIG_WIFI_ESP32=y
CONFIG_HEAP_MEM_POOL_SIZE=131072

CONFIG_NET_L2_ETHERNET=y

CONFIG_NET_DHCPV4=y

CONFIG_NET_CONFIG_LOG_LEVEL_DBG=y
CONFIG_NET_CONFIG_SETTINGS=y
CONFIG_NET_CONFIG_NEED_IPV4=y

CONFIG_MBEDTLS_ENTROPY_ENABLED=y
CONFIG_MBEDTLS_KEY_EXCHANGE_ECDHE_ECDSA_ENABLED=y
CONFIG_MBEDTLS_ECP_ALL_ENABLED=y

CONFIG_ESP32_WIFI_STA_AUTO=y

CONFIG_FLASH=y
CONFIG_FLASH_MAP=y
CONFIG_NVS=y
```

## boards/nrf52840dk_nrf52840.conf
```kconfig
CONFIG_WIFI=y
CONFIG_WIFI_ESP_AT=y
CONFIG_WIFI_ESP_AT_MDM_RX_BUF_COUNT=40

CONFIG_NET_L2_WIFI_SHELL=y
CONFIG_GOLIOTH_SAMPLE_WIFI=y

CONFIG_FLASH=y
CONFIG_FLASH_MAP=y
CONFIG_NVS=y
```

## boards/nrf9160dk_nrf9160_ns.conf
```kconfig
# General config
CONFIG_HEAP_MEM_POOL_SIZE=4096
CONFIG_NEWLIB_LIBC=y

# Networking
CONFIG_NET_NATIVE=n
CONFIG_NET_SOCKETS_OFFLOAD=y

# Use Zephyr mbedTLS, as there was no success so far with using offloaded TLS in
# modem library.
CONFIG_NET_SOCKETS_OFFLOAD_TLS=n

# Increase native TLS socket implementation, so that it is chosen instead of
# offloaded nRF91 sockets
CONFIG_NET_SOCKETS_TLS_PRIORITY=35

# LTE link control
CONFIG_LTE_LINK_CONTROL=y
CONFIG_LTE_AUTO_INIT_AND_CONNECT=y

# Modem library
CONFIG_NRF_MODEM_LIB=y

# Offloaded poll() does not support external events like eventfd, so use timeout
# in poll() instead.
CONFIG_GOLIOTH_SYSTEM_CLIENT_TIMEOUT_USING_POLL=y

# Enable Non-volatile Storage to save settings
CONFIG_FLASH=y
CONFIG_FLASH_MAP=y
CONFIG_NVS=y
```

## boards/qemu_x86.conf
```kconfig
# Kernel options
CONFIG_ENTROPY_GENERATOR=y
CONFIG_TEST_RANDOM_GENERATOR=y

# Static networking
CONFIG_NET_CONFIG_LOG_LEVEL_DBG=y
CONFIG_NET_CONFIG_SETTINGS=y
CONFIG_NET_CONFIG_NEED_IPV4=y
CONFIG_NET_CONFIG_MY_IPV4_ADDR="192.0.2.1"
CONFIG_NET_CONFIG_MY_IPV4_GW="192.0.2.2"
CONFIG_NET_CONFIG_PEER_IPV4_ADDR="192.0.2.2"

# Disable credentials from system settings
CONFIG_GOLIOTH_SYSTEM_SETTINGS=n
```

## src/main.c
```c
/*
 * Copyright (c) 2021 Golioth, Inc.
 *
 * SPDX-License-Identifier: Apache-2.0
 */

#include <zephyr/logging/log.h>
LOG_MODULE_REGISTER(golioth_hello, LOG_LEVEL_DBG);

#include <net/golioth/system_client.h>
#include <net/golioth/settings.h>
#include <samples/common/net_connect.h>
#include <zephyr/init.h>
#include <zephyr/net/coap.h>

static struct golioth_client *client = GOLIOTH_SYSTEM_CLIENT_GET();
static int32_t _loop_delay_s = 5;

enum golioth_settings_status on_setting(
		const char *key,
		const struct golioth_settings_value *value)
{
	LOG_DBG("Received setting: key = %s, type = %d", key, value->type);
	if (strcmp(key, "LOOP_DELAY_S") == 0) {
		/* This setting is expected to be numeric, return an error if it's not */
		if (value->type != GOLIOTH_SETTINGS_VALUE_TYPE_INT64) {
			return GOLIOTH_SETTINGS_VALUE_FORMAT_NOT_VALID;
		}

		/* This setting must be in range [1, 100], return an error if it's not */
		if (value->i64 < 1 || value->i64 > 100) {
			return GOLIOTH_SETTINGS_VALUE_OUTSIDE_RANGE;
		}

		/* Setting has passed all checks, so apply it to the loop delay */
		_loop_delay_s = (int32_t)value->i64;
		LOG_INF("Set loop delay to %d seconds", _loop_delay_s);

		return GOLIOTH_SETTINGS_SUCCESS;
	}

	/* If the setting is not recognized, we should return an error */
	return GOLIOTH_SETTINGS_KEY_NOT_RECOGNIZED;
}

static void golioth_on_connect(struct golioth_client *client)
{
	if (IS_ENABLED(CONFIG_GOLIOTH_SETTINGS)) {
		golioth_settings_observe(client);
	}
}

int main(void)
{
	int counter = 0;
	int err;

	LOG_DBG("Start Hello sample");

	net_connect();

	if (IS_ENABLED(CONFIG_GOLIOTH_SETTINGS)) {
		err = golioth_settings_register_callback(client, on_setting);
		if (err) {
			LOG_ERR("Failed to register settings callback: %d", err);
		}
	}

	client->on_connect = golioth_on_connect;
	golioth_system_client_start();

	while (true) {
		LOG_INF("Sending hello! %d", counter);

		err = golioth_send_hello(client);
		if (err) {
			LOG_WRN("Failed to send hello!");
		}
		++counter;
		k_sleep(K_SECONDS(_loop_delay_s));
	}

	return 0;
}
```

## src/bt.c
```c
/*
 * Copyright (c) 2021 Golioth, Inc.
 *
 * SPDX-License-Identifier: Apache-2.0
 */

#include <logging/log.h>
LOG_MODULE_REGISTER(bt);

#include <bluetooth/bluetooth.h>
#include <init.h>
#include <mgmt/mcumgr/smp_bt.h>

static const struct bt_data ad[] = {
	BT_DATA_BYTES(BT_DATA_FLAGS, (BT_LE_AD_GENERAL | BT_LE_AD_NO_BREDR)),
};

static int bt_init(const struct device *dev)
{
	int err;

	err = bt_enable(NULL);
	if (err) {
		LOG_ERR("Bluetooth init failed (err %d)", err);
		return err;
	}

	if (IS_ENABLED(CONFIG_MCUMGR_SMP_BT)) {
		smp_bt_register();
	}

	LOG_INF("Bluetooth initialized");

	err = bt_le_adv_start(BT_LE_ADV_CONN_NAME, ad, ARRAY_SIZE(ad), NULL, 0);
	if (err) {
		LOG_ERR("Advertising failed to start (err %d)", err);
		return err;
	}

	LOG_INF("Advertising successfully started");

	return 0;
}

SYS_INIT(bt_init, APPLICATION, CONFIG_APPLICATION_INIT_PRIORITY);
```

## src/hwinfo.c
```c
/*
 * Copyright (c) 2021 Golioth, Inc.
 *
 * SPDX-License-Identifier: Apache-2.0
 */
#include <logging/log.h>
LOG_MODULE_REGISTER(hwinfo, LOG_LEVEL_DBG);

#include <zephyr.h>
#include <stdio.h>
#include <stdlib.h>
#include <shell/shell.h>
#include <sys/printk.h>
#include <init.h>

#include <settings/settings.h>

#include <string.h>
#include <drivers/hwinfo.h>

#define DEVICE_ID_BIN_MAX_SIZE 16
#define DEVICE_ID_HEX_MAX_SIZE ((DEVICE_ID_BIN_MAX_SIZE * 2) + 1)

bool get_device_identity(char *id, int id_max_len)
{
  uint8_t hwinfo_id[DEVICE_ID_BIN_MAX_SIZE];
  ssize_t length;

  length = hwinfo_get_device_id(hwinfo_id, DEVICE_ID_BIN_MAX_SIZE);
  if (length <= 0)
  {
    return false;
  }

  memset(id, 0, id_max_len);
  length = bin2hex(hwinfo_id, (size_t)length, id, id_max_len - 1);

  return length > 0;
}

static int hwinfo_settings_get(const char *name, char *dst, int val_len_max)
{
  size_t val_len;

  if (!strcmp(name, "devid"))
  { 
    if (!get_device_identity(dst, val_len_max))
    {
      return -ENOENT;
    }
    val_len = strlen(dst);
  }
  else
  {
    return -ENOENT;
  }

  return val_len;
}

SETTINGS_STATIC_HANDLER_DEFINE(hwinfo, "hwinfo",
                               IS_ENABLED(CONFIG_SETTINGS_RUNTIME) ? hwinfo_settings_get : NULL,
                               NULL, NULL, NULL);
```

## src/mcumgr.c
```c
/*
 * Copyright (c) 2021 Marcin Niestroj
 *
 * SPDX-License-Identifier: Apache-2.0
 */

#include <zephyr.h>
#include <init.h>

#ifdef CONFIG_MCUMGR_CMD_CFG_MGMT
#include "cfg_mgmt/cfg_mgmt.h"
#else
static inline void cfg_mgmt_register_group(void) {}
#endif

#ifdef CONFIG_MCUMGR_CMD_FS_MGMT
#include "fs_mgmt/fs_mgmt.h"
#else
static inline void fs_mgmt_register_group(void) {}
#endif

#ifdef CONFIG_MCUMGR_CMD_IMG_MGMT
#include "img_mgmt/img_mgmt.h"
#else
static inline void img_mgmt_register_group(void) {}
#endif

#ifdef CONFIG_MCUMGR_CMD_LOG_MGMT
#include "log_mgmt/log_mgmt.h"
#else
static inline void log_mgmt_register_group(void) {}
#endif

#ifdef CONFIG_MCUMGR_CMD_OS_MGMT
#include "os_mgmt/os_mgmt.h"
#else
static inline void os_mgmt_register_group(void) {}
#endif

#ifdef CONFIG_MCUMGR_CMD_STAT_MGMT
#include "stat_mgmt/stat_mgmt.h"
#else
static inline void stat_mgmt_register_group(void) {}
#endif

static int mcumgr_init(const struct device *dev)
{
	cfg_mgmt_register_group();
	fs_mgmt_register_group();
	img_mgmt_register_group();
	log_mgmt_register_group();
	os_mgmt_register_group();
	stat_mgmt_register_group();

	return 0;
}

SYS_INIT(mcumgr_init, APPLICATION, CONFIG_APPLICATION_INIT_PRIORITY);
```

## src/settings.c
```c
/*
 * Copyright (c) 2022 Golioth, Inc.
 *
 * SPDX-License-Identifier: Apache-2.0
 */

#include <zephyr.h>
#include <stdio.h>
#include <stdlib.h>
#include <shell/shell.h>
#include <sys/printk.h>
#include <init.h>
#include <ctype.h>

#include <settings/settings.h>

struct settings_read_callback_params {
	const struct shell *shell_ptr;
	bool value_found;
	bool json_output;
};

static int cmd_settings_set(const struct shell *shell, size_t argc, char *argv[])
{
	bool json_output;

	if (argc < 3) {
		shell_fprintf(shell, SHELL_WARNING,
			      "Wrong number of arguments\n");
		shell_help(shell);
		return -ENOEXEC;
	}

	json_output = false;
	if (argc >= 4) {
		if (strcmp(argv[3], "--json") == 0) {
			json_output = true;
		}
	}

	const char *name = argv[1];
	const char *val = argv[2];
	size_t val_len = strlen(val);

	int err;

	shell_fprintf(shell, SHELL_NORMAL, "Setting %s to %s\n", name, val);

#ifdef CONFIG_SETTINGS_RUNTIME
	err = settings_runtime_set(name, val, val_len);
	if (err) {
		if (json_output) {
			shell_fprintf(shell, SHELL_VT100_COLOR_RED,
				"{\"status\": \"failed\", "
				"\"msg\": \"Failed to set runtime setting: %s:%s\"}\n", name, val);
		} else {
			shell_fprintf(shell, SHELL_ERROR,
				      "Failed to set runtime setting: %s:%s\n", name, val);
		}

		return -ENOEXEC;
	}
#endif

	err = settings_save_one(name, val, val_len);
	if (err) {
		if (json_output) {
			shell_fprintf(shell, SHELL_VT100_COLOR_RED,
				"{\"status\": \"failed\", "
				"\"msg\": \"failed to save setting %s:%s\"}\n", name, val);
		} else {
			shell_fprintf(shell, SHELL_ERROR,
				      "Failed to save setting %s:%s\n", name, val);
		}

		return -ENOEXEC;
	}

	if (json_output) {
		shell_fprintf(shell, SHELL_VT100_COLOR_GREEN,
			"{\"status\": \"success\", \"msg\": \"setting %s saved as %s\"}\n",
			name, val);
	} else {
		shell_fprintf(shell, SHELL_NORMAL,
			      "Setting %s saved as %s\n", name, val);
	}

	return 0;
}

static int settings_read_callback(const char *key,
				  size_t len,
				  settings_read_cb read_cb,
				  void            *cb_arg,
				  void            *param)
{
	ssize_t num_read_bytes = MIN(len, SETTINGS_MAX_VAL_LEN);
	uint8_t buffer[num_read_bytes + 1];
	struct settings_read_callback_params *params = param;

	/* Process only the exact match and ignore descendants of the searched name */
	if (settings_name_next(key, NULL) != 0) {
		return 0;
	}

	params->value_found = true;
	num_read_bytes = read_cb(cb_arg, buffer, num_read_bytes);

	if (num_read_bytes < 0) {
		if (params->json_output) {
			shell_fprintf(params->shell_ptr, SHELL_VT100_COLOR_RED,
				"{\"status\": \"failed\", "
				"\"msg\": \"failed to read value: %d\"}\n",
				(int)num_read_bytes);
		} else {
			shell_error(params->shell_ptr, "Failed to read value: %d",
				(int) num_read_bytes);
		}

		return 0;
	}

	/*  add NULL to the last position in the buffer */
	buffer[num_read_bytes] = 0x00;

	if (params->json_output) {
		shell_fprintf(params->shell_ptr, SHELL_VT100_COLOR_GREEN,
			"{\"status\": \"success\", \"value\": \"%s\"}\n", buffer);
	} else {
		shell_fprintf(params->shell_ptr, SHELL_VT100_COLOR_GREEN, "%s\n", buffer);
	}

	if (len > SETTINGS_MAX_VAL_LEN) {
		shell_print(params->shell_ptr, "(The output has been truncated)");
	}

	return 0;
}

static int cmd_settings_get(const struct shell *shell, size_t argc,
			    char *argv[])
{
	bool json_output;

	int err;
	const char *name = argv[1];

	json_output = false;
	if (argc >= 3) {
		if (strcmp(argv[2], "--json") == 0) {
			json_output = true;
		}
	}

	struct settings_read_callback_params params = {
		.shell_ptr = shell,
		.value_found = false,
		.json_output = json_output
	};

	err = settings_load_subtree_direct(name, settings_read_callback, &params);

	if (err) {
		if (json_output) {
			shell_fprintf(shell, SHELL_VT100_COLOR_RED,
				"{\"status\": \"failed\", "
				"\"msg\": \"failed to load settings: %d\"}\n", err);
		} else {
			shell_error(shell, "Failed to load settings: %d", err);
		}
	} else if (!params.value_found) {
		if (json_output) {
			shell_fprintf(shell, SHELL_VT100_COLOR_RED,
				"{\"status\": \"failed\", \"msg\": \"setting not found\"}\n");
		} else {
			shell_error(shell, "Setting not found");
		}
	}

	return 0;
}

SHELL_STATIC_SUBCMD_SET_CREATE(settings_commands,
	SHELL_CMD_ARG(set, NULL,
		"set a module config\n"
		"usage:\n"
		"$ settings set <key> <value>\n"
		"example:\n"
		"$ settings set golioth/psk pre-shared-key-value\n"
		"$ settings set golioth/psk-id psk-identity-value",
		cmd_settings_set, 3, 1),
	SHELL_CMD_ARG(get, NULL,
		"get a module config value\n"
		"usage:\n"
		"$ settings get <key>\n"
		"example:\n"
		"$ settings get golioth/psk\n"
		"$ settings get golioth/psk-id",
		cmd_settings_get, 2, 1),
	SHELL_SUBCMD_SET_END);

SHELL_CMD_REGISTER(settings, &settings_commands, "Settings commands", NULL);
```
