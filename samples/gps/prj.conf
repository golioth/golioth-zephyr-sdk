## CMakeLists.txt
```
# SPDX-License-Identifier: Apache-2.0

cmake_minimum_required(VERSION 3.13.1)

find_package(Zephyr REQUIRED HINTS $ENV{ZEPHYR_BASE})
project(example-app)

target_sources(app PRIVATE src/main.c src/gps.c)
```

## sample.yaml
```
sample:
  description: Log GPS fix to Golioth server
  name: gps
common:
  harness: net
  platform_allow: esp32 circuitdojo_feather_nrf9160ns
  tags: golioth gps asset tracker
tests:
  sample.golioth.gps: {}
```

## prj.conf
```kconfig
# Generic networking options
CONFIG_NETWORKING=y
CONFIG_NET_IPV4=y
CONFIG_NET_IPV6=n

# Logging
CONFIG_NET_LOG=y

# Network Shell
CONFIG_NET_SHELL=y

# TLS configuration
CONFIG_MBEDTLS_ENABLE_HEAP=y
CONFIG_MBEDTLS_HEAP_SIZE=8192
CONFIG_MBEDTLS_SSL_MAX_CONTENT_LEN=2048

# Application
CONFIG_MAIN_STACK_SIZE=4096
CONFIG_EVENTFD=y

CONFIG_GOLIOTH=y
CONFIG_GOLIOTH_SYSTEM_CLIENT=y

CONFIG_TINYCBOR=y
CONFIG_CBOR_FLOATING_POINT=y

CONFIG_LOG_BACKEND_GOLIOTH=y
CONFIG_LOG_PROCESS_THREAD_STACK_SIZE=2048

CONFIG_GOLIOTH_SYSTEM_CLIENT_PSK_ID="nrf9160-psk-id"
CONFIG_GOLIOTH_SYSTEM_CLIENT_PSK="nrf9160-psk"

# CONFIG_NRF9160_GPS=y
# CONFIG_NRF9160_GPS_SET_COEX0=y
# CONFIG_NRF9160_GPS_COEX0_STRING="AT%XCOEX0=1,1,1565,1586"
```

## boards/circuitdojo_feather_nrf9160ns.conf
```kconfig
# General config
CONFIG_HEAP_MEM_POOL_SIZE=4096
CONFIG_NEWLIB_LIBC=y

# Networking
CONFIG_NET_NATIVE=n
CONFIG_NET_SOCKETS_OFFLOAD=y

# Use Zephyr mbedTLS, as there was no success so far with using offloaded TLS in
# modem library.
CONFIG_NET_SOCKETS_OFFLOAD_TLS=n

# LTE link control
CONFIG_LTE_LINK_CONTROL=y
CONFIG_LTE_AUTO_INIT_AND_CONNECT=y

# Modem library
CONFIG_NRF_MODEM_LIB=y

# Workaround for https://devzone.nordicsemi.com/f/nordic-q-a/75839/nrf-samples-nrf9160-mqtt_simple-bus-fault
CONFIG_FPU=y

# Offloaded poll() does not support external events like eventfd, so use timeout
# in poll() instead.
CONFIG_GOLIOTH_SYSTEM_CLIENT_TIMEOUT_USING_POLL=y

CONFIG_BOOTLOADER_MCUBOOT=y
```

## boards/esp32.conf
```kconfig
CONFIG_WIFI=y
CONFIG_WIFI_ESP32=y
CONFIG_HEAP_MEM_POOL_SIZE=131072

CONFIG_NET_L2_ETHERNET=y

CONFIG_NET_DHCPV4=y

CONFIG_NET_CONFIG_LOG_LEVEL_DBG=y
CONFIG_NET_CONFIG_SETTINGS=y
CONFIG_NET_CONFIG_NEED_IPV4=y

CONFIG_MBEDTLS_ENTROPY_ENABLED=y
CONFIG_MBEDTLS_KEY_EXCHANGE_ECDHE_ECDSA_ENABLED=y
CONFIG_MBEDTLS_ECP_ALL_ENABLED=y

CONFIG_ESP32_WIFI_STA_AUTO=y
```

## src/main.c
```c
/*
 * Copyright (c) 2021 Golioth, Inc.
 *
 * SPDX-License-Identifier: Apache-2.0
 */

#include <logging/log.h>
LOG_MODULE_REGISTER(golioth_logging, LOG_LEVEL_DBG);

#include <net/coap.h>
#include <tinycbor/cbor.h>
#include <tinycbor/cbor_buf_writer.h>
#include <net/golioth/system_client.h>
#include <net/golioth/wifi.h>

#include "gps.h"

static struct golioth_client *client = GOLIOTH_SYSTEM_CLIENT_GET();

static void print_gps_satellite_stats(nrf_gnss_data_frame_t *gps_data) {
    uint8_t tracked, in_fix, unhealthy;

    gps_satellite_stats(gps_data, &tracked, &in_fix, &unhealthy);

    printk("Tracking: %d, Using: [%d/%d], Unhealthy: [%d/%d]\n", tracked, in_fix, tracked, unhealthy, tracked);
}

static void print_gps_fix_data(nrf_gnss_data_frame_t *gps_data)
{
    printk("Longitude:  %f\n", gps_data->pvt.longitude);
    printk("Latitude:   %f\n", gps_data->pvt.latitude);
    printk("Altitude:   %f\n", gps_data->pvt.altitude);
    printk("Speed:      %f\n", gps_data->pvt.speed);
    printk("Heading:    %f\n", gps_data->pvt.heading);
}

static void upload_gps_fix_data(nrf_gnss_data_frame_t *gps_data)
{
    uint8_t buf[128];
    struct cbor_buf_writer buf_writer;
    CborEncoder encoder, map_encoder;
    CborError cbor_err = CborNoError;
    int golioth_err;

    cbor_buf_writer_init(&buf_writer, buf, sizeof(buf));
    cbor_encoder_init(&encoder, &buf_writer.enc, 0);

    cbor_err |= cbor_encoder_create_map(&encoder, &map_encoder, 1);

    cbor_err |= cbor_encode_text_stringz(&map_encoder, "longitude");
    cbor_err |= cbor_encode_float(&map_encoder, gps_data->pvt.longitude);

    cbor_err |= cbor_encode_text_stringz(&map_encoder, "latitude");
    cbor_err |= cbor_encode_float(&map_encoder, gps_data->pvt.latitude);

    cbor_err |= cbor_encode_text_stringz(&map_encoder, "altitude");
    cbor_err |= cbor_encode_float(&map_encoder, gps_data->pvt.altitude);

    cbor_err |= cbor_encode_text_stringz(&map_encoder, "speed");
    cbor_err |= cbor_encode_float(&map_encoder, gps_data->pvt.speed);

    cbor_err |= cbor_encode_text_stringz(&map_encoder, "heading");
    cbor_err |= cbor_encode_float(&map_encoder, gps_data->pvt.heading);

    cbor_err |= cbor_encoder_close_container(&encoder, &map_encoder);

    // If any errors other than `CborOutOfMemory` occured, abort.
    if ((cbor_err & ~(CborNoError | CborErrorOutOfMemory)) != 0) {
        LOG_ERR("failed to generate gps fix cbor data");
        return;
    }

    if ((cbor_err & CborErrorOutOfMemory) != 0) {
        LOG_WRN("the buffer is too small to cbor encode the GPS fix.");
        return;
    }

    // Push the GPS fix data to a LightDB stream called `gps`.
    golioth_err = golioth_lightdb_set(
        client,
        GOLIOTH_LIGHTDB_STREAM_PATH("gps"),
        COAP_CONTENT_FORMAT_APP_CBOR,
        buf, cbor_buf_writer_buffer_size(&buf_writer, buf)
    );

    if (golioth_err) {
        LOG_ERR("Failed to push GPS fix data to stream: %d", golioth_err);
    }
}

void main(void)
{
    nrf_gnss_data_frame_t gps_data;

    LOG_INF("Starting GPS Sample...");

    if (gps_init() != 0) {
        LOG_ERR("Failed to init GPS");
    }

    if (IS_ENABLED(CONFIG_GOLIOTH_SAMPLE_WIFI)) {
        LOG_INF("Connecting to WiFi");
        wifi_connect();
    }

    golioth_system_client_start();

    while (true) {
        // Loop until we don't have any more data to read.
        while (gps_process_data(&gps_data) > 0) {}

        print_gps_satellite_stats(&gps_data);

        if (gps_has_fix()) {
            print_gps_fix_data(&gps_data);
            upload_gps_fix_data(&gps_data);
        } else {
            printk("No gps data available\n");
            printk("Seconds since last GPS fix: %lld\n", gps_msec_since_last_fix() / 1000);
        }

        k_sleep(K_SECONDS(5));
    }
}
```

## src/gps.c
```c
/*
 * Copyright (c) 2021 Golioth, Inc.
 * Copyright (c) 2019 Nordic Semiconductor ASA
 *
 * SPDX-License-Identifier: LicenseRef-BSD-5-Clause-Nordic
 */

#include <net/socket.h>
#include <modem/at_cmd.h>
#include <modem/at_notif.h>

#include "gps.h"

#define AT_XSYSTEMMODE      "AT\%XSYSTEMMODE=1,0,1,0"
#define AT_ACTIVATE_GPS     "AT+CFUN=31"
// #define AT_COEX0            "AT\\%XCOEX0=1,1,1570,1580"
#define AT_COEX0			"AT%XCOEX0=1,1,1565,1586"

#define GNSS_INIT_AND_START 1
#define GNSS_STOP           2
#define GNSS_RESTART        3

static int                   gnss_fd;
static char                  nmea_strings[10][NRF_GNSS_NMEA_MAX_LEN];
static uint32_t              nmea_string_cnt;

static bool                  got_fix = false;
static uint64_t              fix_timestamp;
static nrf_gnss_data_frame_t in_progress_pvt = { 0 };

static const char *const at_commands[] = {
    AT_XSYSTEMMODE,
    AT_COEX0,
    AT_ACTIVATE_GPS
};

static int setup_modem(void)
{
    int res;
    for (int i = 0; i < ARRAY_SIZE(at_commands); i++) {
        res = at_cmd_write(at_commands[i], NULL, 0, NULL);
        if (res != 0) {
            printk("Failed to write AT command[%d], err: %d\n", i, res);
            return -1;
        }
    }

    return 0;
}

static int gnss_ctrl(uint32_t ctrl)
{
    int retval;

    nrf_gnss_fix_retry_t    fix_retry    = 0;
    nrf_gnss_fix_interval_t fix_interval = 1;
    nrf_gnss_delete_mask_t	delete_mask  = 0;
    nrf_gnss_nmea_mask_t	nmea_mask    = NRF_GNSS_NMEA_GSV_MASK |
                           NRF_GNSS_NMEA_GSA_MASK |
                           NRF_GNSS_NMEA_GLL_MASK |
                           NRF_GNSS_NMEA_GGA_MASK |
                           NRF_GNSS_NMEA_RMC_MASK;

    if (ctrl == GNSS_INIT_AND_START) {
        gnss_fd = nrf_socket(NRF_AF_LOCAL,
                     NRF_SOCK_DGRAM,
                     NRF_PROTO_GNSS);

        if (gnss_fd >= 0) {
            printk("GPS Socket created\n");
        } else {
            printk("Could not init socket (err: %d)\n", gnss_fd);
            return -1;
        }

        retval = nrf_setsockopt(gnss_fd,
                    NRF_SOL_GNSS,
                    NRF_SO_GNSS_FIX_RETRY,
                    &fix_retry,
                    sizeof(fix_retry));
        if (retval != 0) {
            printk("Failed to set fix retry value\n");
            return -1;
        }

        retval = nrf_setsockopt(gnss_fd,
                    NRF_SOL_GNSS,
                    NRF_SO_GNSS_FIX_INTERVAL,
                    &fix_interval,
                    sizeof(fix_interval));
        if (retval != 0) {
            printk("Failed to set fix interval value\n");
            return -1;
        }

        retval = nrf_setsockopt(gnss_fd,
                    NRF_SOL_GNSS,
                    NRF_SO_GNSS_NMEA_MASK,
                    &nmea_mask,
                    sizeof(nmea_mask));
        if (retval != 0) {
            printk("Failed to set nmea mask\n");
            return -1;
        }
    }

    if ((ctrl == GNSS_INIT_AND_START) ||
        (ctrl == GNSS_RESTART)) {
        retval = nrf_setsockopt(gnss_fd,
                    NRF_SOL_GNSS,
                    NRF_SO_GNSS_START,
                    &delete_mask,
                    sizeof(delete_mask));
        if (retval != 0) {
            printk("Failed to start GPS\n");
            return -1;
        }
    }

    if (ctrl == GNSS_STOP) {
        retval = nrf_setsockopt(gnss_fd,
                    NRF_SOL_GNSS,
                    NRF_SO_GNSS_STOP,
                    &delete_mask,
                    sizeof(delete_mask));
        if (retval != 0) {
            printk("Failed to stop GPS\n");
            return -1;
        }
    }

    return 0;
}

int gps_init(void)
{
    int retval;

    if (setup_modem() != 0) {
        printk("Failed to initialize modem\n");
        return -1;
    }

    retval = gnss_ctrl(GNSS_INIT_AND_START);

    return retval;
}

int gps_process_data(nrf_gnss_data_frame_t *gps_data)
{
    int retval;

    retval = nrf_recv(gnss_fd,
              &in_progress_pvt,
              sizeof(nrf_gnss_data_frame_t),
              NRF_MSG_DONTWAIT);

    if (retval > 0) {
        switch (in_progress_pvt.data_id) {
            case NRF_GNSS_PVT_DATA_ID:
                memcpy(&in_progress_pvt,
                        gps_data,
                        sizeof(nrf_gnss_data_frame_t));

                nmea_string_cnt = 0;
                got_fix = false;

                if ((in_progress_pvt.pvt.flags &
                    NRF_GNSS_PVT_FLAG_FIX_VALID_BIT)
                    == NRF_GNSS_PVT_FLAG_FIX_VALID_BIT)
                {

                    got_fix = true;
                    fix_timestamp = k_uptime_get();
                }
                break;

            case NRF_GNSS_NMEA_DATA_ID:
                if (nmea_string_cnt < 10) {
                    memcpy(nmea_strings[nmea_string_cnt++],
                        in_progress_pvt.nmea,
                        retval);
                }
                break;

            default:
                break;
        }
    }

    return retval;
}

bool gps_has_fix(void)
{
    return got_fix;
}

uint64_t gps_msec_since_last_fix(void)
{
    return k_uptime_get() - fix_timestamp;
}

void gps_satellite_stats(nrf_gnss_data_frame_t *gps_data, uint8_t *tracked, uint8_t* in_fix, uint8_t *unhealthy)
{
    *tracked = 0;
    *in_fix = 0;
    *unhealthy = 0;

    for (int i = 0; i < NRF_GNSS_MAX_SATELLITES; ++i) {
        if ((in_progress_pvt.pvt.sv[i].sv > 0) &&
            (in_progress_pvt.pvt.sv[i].sv < 33))
        {
            (*tracked)++;

            if (in_progress_pvt.pvt.sv[i].flags & NRF_GNSS_SV_FLAG_USED_IN_FIX) {
                (*in_fix)++;
            }

            if (in_progress_pvt.pvt.sv[i].flags & NRF_GNSS_SV_FLAG_UNHEALTHY) {
                (*unhealthy)++;
            }
        }
    }
}
```

## src/gps.h
```c
/*
 * Copyright (c) 2021 Golioth, Inc.
 * Copyright (c) 2019 Nordic Semiconductor ASA
 *
 * SPDX-License-Identifier: LicenseRef-BSD-5-Clause-Nordic
 */

#ifndef GPS_H
#define GPS_H

#include <nrf_socket.h>

#ifdef __cplusplus
extern "C" {
#endif

int gps_init(void);

int gps_process_data(nrf_gnss_data_frame_t *gps_data);

bool gps_has_fix(void);
uint64_t gps_msec_since_last_fix(void);
void gps_satellite_stats(nrf_gnss_data_frame_t *gps_data, uint8_t *tracked, uint8_t* in_fix, uint8_t *unhealthy);

#ifdef __cplusplus
}
#endif

#endif /* GPS_H */
```
