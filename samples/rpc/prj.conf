## CMakeLists.txt
```
# SPDX-License-Identifier: Apache-2.0

cmake_minimum_required(VERSION 3.20.0)

set(SNIPPET golioth-sample)

find_package(Zephyr REQUIRED HINTS $ENV{ZEPHYR_BASE})
project(rpc)

target_sources(app PRIVATE src/main.c)
```

## sample.yaml
```
sample:
  description: Handle RPC method from Golioth server
  name: rpc
common:
  harness: pytest
  tags: golioth socket goliothd
tests:
  sample.golioth.rpc:
    platform_allow: >
      esp32_devkitc_wroom
      mimxrt1060_evkb
      nrf52840dk_nrf52840
      nrf9160dk_nrf9160_ns
      qemu_x86
```

## prj.conf
```kconfig
CONFIG_GOLIOTH_SAMPLES_COMMON=y

# Application
CONFIG_LOG_BACKEND_GOLIOTH=y

CONFIG_GOLIOTH_RPC=y
CONFIG_CBPRINTF_FP_SUPPORT=y
```

## boards/esp32.conf
```kconfig
CONFIG_WIFI=y
CONFIG_WIFI_ESP32=y
CONFIG_HEAP_MEM_POOL_SIZE=98304

CONFIG_NET_L2_ETHERNET=y

CONFIG_NET_DHCPV4=y

CONFIG_NET_CONFIG_LOG_LEVEL_DBG=y
CONFIG_NET_CONFIG_SETTINGS=y
CONFIG_NET_CONFIG_NEED_IPV4=y

CONFIG_MBEDTLS_ENTROPY_ENABLED=y
CONFIG_MBEDTLS_KEY_EXCHANGE_ECDHE_ECDSA_ENABLED=y
CONFIG_MBEDTLS_ECP_ALL_ENABLED=y

CONFIG_ESP32_WIFI_STA_AUTO=y
```

## boards/native_sim.conf
```kconfig
# Static networking
CONFIG_NET_CONFIG_LOG_LEVEL_DBG=y
CONFIG_NET_CONFIG_SETTINGS=y
CONFIG_NET_CONFIG_NEED_IPV4=y
CONFIG_NET_CONFIG_MY_IPV4_ADDR="192.0.2.1"
CONFIG_NET_CONFIG_MY_IPV4_GW="192.0.2.2"
CONFIG_NET_CONFIG_PEER_IPV4_ADDR="192.0.2.2"

# Golioth logging backend requirement
CONFIG_LOG_MODE_DEFERRED=y
```

## boards/nrf9160dk_nrf9160_ns.conf
```kconfig
#
# Copyright (c) 2021 Golioth, Inc.
#
# SPDX-License-Identifier: Apache-2.0

# General config
CONFIG_HEAP_MEM_POOL_SIZE=4096
CONFIG_NEWLIB_LIBC=y

# Networking
CONFIG_NET_NATIVE=n
CONFIG_NET_SOCKETS_OFFLOAD=y

# Increase native TLS socket implementation, so that it is chosen instead of
# offloaded nRF91 sockets
CONFIG_NET_SOCKETS_TLS_PRIORITY=35

# LTE link control
CONFIG_LTE_LINK_CONTROL=y
CONFIG_LTE_AUTO_INIT_AND_CONNECT=y

# Modem library
CONFIG_NRF_MODEM_LIB=y

# Disable options y-selected by NCS for no good reason
CONFIG_MBEDTLS_KEY_EXCHANGE_DHE_PSK_ENABLED=n
CONFIG_MBEDTLS_KEY_EXCHANGE_DHE_RSA_ENABLED=n
# ... also increase heap size to "high enough to make it work"
CONFIG_MBEDTLS_HEAP_SIZE=49152
```

## src/main.c
```c
/*
 * Copyright (c) 2021 Golioth, Inc.
 *
 * SPDX-License-Identifier: Apache-2.0
 */

#include <zephyr/logging/log.h>
LOG_MODULE_REGISTER(golioth_rpc, LOG_LEVEL_DBG);

#include <zephyr/net/coap.h>
#include <net/golioth/system_client.h>
#include <net/golioth/rpc.h>
#include <samples/common/net_connect.h>

static struct golioth_client *client = GOLIOTH_SYSTEM_CLIENT_GET();

static enum golioth_rpc_status on_multiply(zcbor_state_t *request_params_array,
					   zcbor_state_t *response_detail_map,
					   void *callback_arg)
{
	double a, b;
	double value;
	bool ok;

	ok = zcbor_float_decode(request_params_array, &a) &&
	     zcbor_float_decode(request_params_array, &b);
	if (!ok) {
		LOG_ERR("Failed to decode array items");
		return GOLIOTH_RPC_INVALID_ARGUMENT;
	}

	value = a * b;

	LOG_DBG("%lf * %lf = %lf", a, b, value);

	ok = zcbor_tstr_put_lit(response_detail_map, "value") &&
	     zcbor_float64_put(response_detail_map, value);
	if (!ok) {
		LOG_ERR("Failed to encode value");
		return GOLIOTH_RPC_RESOURCE_EXHAUSTED;
	}

	return GOLIOTH_RPC_OK;
}

static void golioth_on_connect(struct golioth_client *client)
{
	int err = golioth_rpc_observe(client);
	if (err) {
		LOG_ERR("Failed to observe RPC: %d", err);
	}
}

int main(void)
{
	LOG_DBG("Start RPC sample");

	net_connect();

	client->on_connect = golioth_on_connect;
	golioth_system_client_start();

	int err = golioth_rpc_register(client, "multiply", on_multiply, NULL);

	if (err) {
		LOG_ERR("Failed to register RPC: %d", err);
	}

	while (true) {
		k_sleep(K_SECONDS(5));
	}

	return 0;
}
```
