## CMakeLists.txt
```
# SPDX-License-Identifier: Apache-2.0

cmake_minimum_required(VERSION 3.20.0)

find_package(Zephyr REQUIRED HINTS $ENV{ZEPHYR_BASE})
project(shell)

target_sources(app PRIVATE
  src/main.c
  src/golioth.c
  src/tls_credential.c
)
```

## sample.yaml
```
sample:
  description: Golioth interaction over shell
  name: shell
common:
  harness: net shell
  platform_allow: >
    esp32
    nrf52840dk_nrf52840
    nrf9160dk_nrf9160_ns
    qemu_x86
  tags: golioth net socket
tests:
  sample.golioth.shell: {}
```

## prj.conf
```kconfig
CONFIG_GOLIOTH_SAMPLES_COMMON=y

# Generic networking options
CONFIG_NETWORKING=y
CONFIG_NET_IPV4=y
CONFIG_NET_IPV6=n

# Logging
CONFIG_NET_LOG=y

# Network Shell
CONFIG_NET_SHELL=y

# TLS configuration
CONFIG_MBEDTLS_ENABLE_HEAP=y
CONFIG_MBEDTLS_HEAP_SIZE=10240
CONFIG_MBEDTLS_SSL_MAX_CONTENT_LEN=2048

# Application
CONFIG_MAIN_STACK_SIZE=4096

CONFIG_GOLIOTH=y

CONFIG_MINIMAL_LIBC_MALLOC_ARENA_SIZE=4096

CONFIG_BASE64=y
CONFIG_SHELL_GETOPT=y
```

## boards/esp32.conf
```kconfig
CONFIG_WIFI=y
CONFIG_WIFI_ESP32=y
CONFIG_HEAP_MEM_POOL_SIZE=131072

CONFIG_NET_L2_ETHERNET=y

CONFIG_NET_DHCPV4=y

CONFIG_NET_CONFIG_LOG_LEVEL_DBG=y
CONFIG_NET_CONFIG_SETTINGS=y
CONFIG_NET_CONFIG_NEED_IPV4=y

CONFIG_MBEDTLS_ENTROPY_ENABLED=y
CONFIG_MBEDTLS_KEY_EXCHANGE_ECDHE_ECDSA_ENABLED=y
CONFIG_MBEDTLS_ECP_ALL_ENABLED=y

CONFIG_ESP32_WIFI_STA_AUTO=y
```

## boards/nrf9160dk_nrf9160_ns.conf
```kconfig
#
# Copyright (c) 2021 Golioth, Inc.
#
# SPDX-License-Identifier: Apache-2.0

# General config
CONFIG_HEAP_MEM_POOL_SIZE=4096
CONFIG_NEWLIB_LIBC=y

# Networking
CONFIG_NET_NATIVE=n
CONFIG_NET_SOCKETS_OFFLOAD=y

# Increase native TLS socket implementation, so that it is chosen instead of
# offloaded nRF91 sockets
CONFIG_NET_SOCKETS_TLS_PRIORITY=35

# LTE link control
CONFIG_LTE_LINK_CONTROL=y
CONFIG_LTE_AUTO_INIT_AND_CONNECT=y

# Modem library
CONFIG_NRF_MODEM_LIB=y

# Offloaded poll() does not support external events like eventfd, so use timeout
# in poll() instead.
CONFIG_GOLIOTH_SYSTEM_CLIENT_TIMEOUT_USING_POLL=y

# Conflicts with MBEDTLS_DTLS
CONFIG_BUILD_WITH_TFM=n
```

## src/main.c
```c
/*
 * Copyright (c) 2022 Golioth, Inc.
 *
 * SPDX-License-Identifier: Apache-2.0
 */

#include <zephyr/logging/log.h>
LOG_MODULE_REGISTER(golioth_shell, LOG_LEVEL_DBG);

#include <net/golioth.h>
#include <samples/common/wifi.h>

#include "common.h"

static void golioth_on_message(struct golioth_client *client,
			       struct coap_packet *rx)
{
	uint16_t payload_len;
	const uint8_t *payload;
	uint8_t type;

	type = coap_header_get_type(rx);
	payload = coap_packet_get_payload(rx, &payload_len);

	if (!IS_ENABLED(CONFIG_LOG_BACKEND_GOLIOTH) && payload) {
		LOG_HEXDUMP_DBG(payload, payload_len, "Payload");
	}
}

static uint8_t golioth_shell_rx_buffer[2048];

void main(void)
{
	golioth_init(client);

	client->rx_buffer = golioth_shell_rx_buffer;
	client->rx_buffer_len = sizeof(golioth_shell_rx_buffer);

	client->on_message = golioth_on_message;

	LOG_DBG("Start Golioth shell sample");

	if (IS_ENABLED(CONFIG_GOLIOTH_SAMPLE_WIFI)) {
		LOG_INF("Connecting to WiFi");
		wifi_connect();
	}

	LOG_INF("Ready");
}
```

## src/common.h
```c
/*
 * Copyright (c) 2022 Golioth, Inc.
 *
 * SPDX-License-Identifier: Apache-2.0
 */

#ifndef __SAMPLES_SHELL_COMMON_H__
#define __SAMPLES_SHELL_COMMON_H__

struct golioth_client;

extern struct golioth_client *client;

#endif /* __SAMPLES_SHELL_COMMON_H__ */
```

## src/golioth.c
```c
/*
 * Copyright (c) 2022 Golioth, Inc.
 *
 * SPDX-License-Identifier: Apache-2.0
 */

#include <zephyr/logging/log.h>
LOG_MODULE_DECLARE(golioth_shell);

#include <logging/golioth.h>
#include <net/golioth.h>
#include <stdlib.h>
#include <zephyr/net/coap.h>
#include <zephyr/shell/shell.h>

#include "common.h"

static struct golioth_client golioth_shell_client;
struct golioth_client *client = &golioth_shell_client;

static int cmd_golioth_connect(const struct shell *sh, size_t argc, char **argv)
{
	const char *host = argv[1];
	unsigned long port = 5684;
	int err;

	if (argc > 2) {
		const char *port_s = argv[2];

		port = strtoul(port_s, NULL, 0);
	}

	err = golioth_connect(client, host, port);
	if (err) {
		if (err == -EALREADY) {
			shell_warn(sh, "Already connected");
		} else {
			shell_error(sh, "Failed to connect: %d", err);
		}

		return err;
	}

	return 0;
}

static int cmd_golioth_disconnect(const struct shell *sh, size_t argc, char **argv)
{
	int err;

	err = golioth_disconnect(client);
	if (err) {
		if (err == -ENOTCONN) {
			shell_warn(sh, "Already disconnected");
		} else {
			shell_error(sh, "Failed to disconnect: %d", err);
		}

		return err;
	}

	return 0;
}

static int cmd_golioth_is_connected(const struct shell *sh, size_t argc, char **argv)
{
	bool connected;

	connected = golioth_is_connected(client);
	shell_print(sh, "%s", connected ? "Connected" : "Disconnected");

	return 0;
}

static int cmd_golioth_set_coap_dtls(const struct shell *sh, size_t argc, char **argv)
{
	static sec_tag_t *tags;
	static size_t num_tags;
	int err;

	/*
	 * 'tags' is either NULL or a valid pointer to heap.
	 * In the former case free(NULL) will be a noop, so we call it unconditionally.
	 */
	free(tags);
	num_tags = 0;

	num_tags = (argc - 1);
	tags = malloc(num_tags * sizeof(*tags));

	for (int i = 1; i < argc; i++) {
		long tag = strtol(argv[i], NULL, 0);

		tags[i - 1] = tag;
	}

	err = golioth_set_proto_coap_dtls(client, tags, num_tags);
	if (err) {
		shell_error(sh, "Failed set CoAP DTLS: %d", err);
		return err;
	}

	return 0;
}

static int cmd_golioth_process_rx(const struct shell *sh, size_t argc, char **argv)
{
	int err;

	err = golioth_process_rx(client);
	if (err) {
		shell_error(sh, "Failed to process RX: %d", err);
		return err;
	}

	return 0;
}

static int cmd_golioth_ping(const struct shell *sh, size_t argc, char **argv)
{
	int err;

	err = golioth_ping(client);
	if (err) {
		shell_error(sh, "Failed to ping: %d", err);
		return err;
	}

	return 0;
}

static int cmd_golioth_hello(const struct shell *sh, size_t argc, char **argv)
{
	int err;

	err = golioth_send_hello(client);
	if (err) {
		shell_error(sh, "Failed to send hello: %d", err);
		return err;
	}

	return 0;
}

static int cmd_golioth_log_backend_init(const struct shell *sh, size_t argc, char **argv)
{
	int err;

	if (!IS_ENABLED(CONFIG_LOG_BACKEND_GOLIOTH)) {
		shell_error(sh, "Golioth log backend is not enabled");
		return -ENOSYS;
	}

	err = log_backend_golioth_init(client);
	if (err) {
		shell_error(sh, "Failed to initialize Golioth log backend: %d", err);
		return err;
	}

	return 0;
}

SHELL_STATIC_SUBCMD_SET_CREATE(cmds_golioth,
	SHELL_CMD_ARG(connect, NULL,
		"Connect", cmd_golioth_connect, 2, 1),
	SHELL_CMD_ARG(disconnect, NULL,
		"Disconnect", cmd_golioth_disconnect, 1, 0),
	SHELL_CMD_ARG(is_connected, NULL,
		"Is connected?", cmd_golioth_is_connected, 1, 0),
	SHELL_CMD(set_coap_dtls, NULL,
		"Set CoAP DTLS", cmd_golioth_set_coap_dtls),
	SHELL_CMD_ARG(process_rx, NULL,
		"Process RX", cmd_golioth_process_rx, 1, 0),
	SHELL_CMD_ARG(ping, NULL,
		"Ping", cmd_golioth_ping, 1, 0),
	SHELL_CMD_ARG(hello, NULL,
		"Send hello", cmd_golioth_hello, 1, 0),
	SHELL_CMD_ARG(log_backend_init, NULL,
		"Initialize log backend", cmd_golioth_log_backend_init, 1, 0),
	SHELL_SUBCMD_SET_END
);

SHELL_CMD_REGISTER(golioth, &cmds_golioth, "Golioth shell", NULL);
```

## src/tls_credential.c
```c
/*
 * Copyright (c) 2022 Golioth, Inc.
 *
 * SPDX-License-Identifier: Apache-2.0
 */

#include <zephyr/logging/log.h>
LOG_MODULE_DECLARE(golioth_shell);

#include <stdlib.h>
#include <zephyr/net/tls_credentials.h>
#include <zephyr/shell/shell.h>
#include <zephyr/sys/base64.h>

#ifndef SHELL_VT100_ASCII_CTRL_D
#define SHELL_VT100_ASCII_CTRL_D	(0x04)
#endif

enum bypass_content_format {
	BYPASS_CONTENT_FORMAT_TEXT,
	BYPASS_CONTENT_FORMAT_BASE64,
};

struct bypass_content_format_info {
	const char *name;
	enum bypass_content_format content_format;
};

static const struct bypass_content_format_info bypass_content_formats[] = {
	{ "text", BYPASS_CONTENT_FORMAT_TEXT },
	{ "base64", BYPASS_CONTENT_FORMAT_BASE64 },
};

struct bypass_ctx {
	long tag;
	enum tls_credential_type type;
	uint8_t *data;
	size_t len;
	enum bypass_content_format content_format;
	uint8_t base64_buf[4];
	uint8_t base64_buf_len;
};

struct tls_credential_type_info {
	const char *name;
	enum tls_credential_type type;
};

static struct bypass_ctx shell_bypass_context;

static const struct tls_credential_type_info credential_type_info[] = {
	{"none", TLS_CREDENTIAL_NONE},
	{"ca-certificate", TLS_CREDENTIAL_CA_CERTIFICATE},
	{"server-certificate", TLS_CREDENTIAL_SERVER_CERTIFICATE},
	{"private-key", TLS_CREDENTIAL_PRIVATE_KEY},
	{"psk", TLS_CREDENTIAL_PSK},
	{"psk-id", TLS_CREDENTIAL_PSK_ID},
};

static enum tls_credential_type tls_credential_str_to_type(const char *str)
{
	const struct tls_credential_type_info *info;

	for (info = credential_type_info;
	     info < &credential_type_info[ARRAY_SIZE(credential_type_info)];
	     info++) {
		if (!strcmp(info->name, str)) {
			return info->type;
		}
	}

	return TLS_CREDENTIAL_NONE;
}

static int bypass_consume_text(const struct shell *sh, struct bypass_ctx *ctx,
			       uint8_t *data, size_t len)
{
	void *old_data = ctx->data;

	ctx->data = realloc(old_data, ctx->len + len);
	if (!ctx->data) {
		free(old_data);
		ctx->len = 0;
		shell_error(sh, "Not enough memory");
		return -ENOMEM;
	}

	memcpy(&ctx->data[ctx->len], data, len);
	ctx->len += len;

	return 0;
}

static int bypass_consume_base64(const struct shell *sh, struct bypass_ctx *ctx,
				 uint8_t *data, size_t len)
{
	uint8_t *orig_data = data;
	size_t orig_len = len;
	uint8_t *data_end = &data[len];
	size_t olen;
	int err;

	while (data < data_end) {
		void *old_data = ctx->data;
		size_t copy_len = MIN(sizeof(ctx->base64_buf) - ctx->base64_buf_len,
				      data_end - data);

		memcpy(&ctx->base64_buf[ctx->base64_buf_len], data, copy_len);
		ctx->base64_buf_len += copy_len;
		data += copy_len;

		if (ctx->base64_buf_len < sizeof(ctx->base64_buf)) {
			/* Not enough data to process */
			break;
		}

		ctx->data = realloc(old_data, ctx->len + 3);
		if (!ctx->data) {
			free(old_data);
			ctx->len = 0;
			shell_error(sh, "Not enough memory");
			return -ENOMEM;
		}

		err = base64_decode(&ctx->data[ctx->len], 3, &olen,
				    ctx->base64_buf, sizeof(ctx->base64_buf));
		if (err) {
			shell_error(sh, "Failed to decode base64: %d", err);
			shell_hexdump(sh, ctx->base64_buf, sizeof(ctx->base64_buf));
			shell_hexdump(sh, &ctx->data[ctx->len], 3);
			shell_error(sh, "ctx->len %zu", (size_t) ctx->len);
			shell_error(sh, "data, len dump");
			shell_hexdump(sh, orig_data, orig_len);
			free(ctx->data);
			ctx->len = 0;
			return err;
		}

		ctx->base64_buf_len = 0;
		ctx->len += olen;
	}

	return 0;
}

static void bypass_finish(const struct shell *sh, struct bypass_ctx *ctx)
{
	free(ctx->data);
	ctx->data = NULL;

	ctx->len = 0;

	shell_print(sh, ""); /* newline */
	shell_set_bypass(sh, NULL);
}

static void bypass_cb(const struct shell *sh, uint8_t *data, size_t len)
{
	struct bypass_ctx *ctx = &shell_bypass_context;
	bool end_of_input = false;
	int err;

	for (uint8_t *p = data; p < &data[len]; p++) {
		if (*p == SHELL_VT100_ASCII_CTRL_D) {
			size_t processed_len = p - data;

			/* This char is not part of data, so adjust for that */
			len -= 1;

			if (processed_len < len) {
				shell_warn(sh, "Discarding %zu bytes following Ctrl+D",
					   (len - processed_len));
				len = processed_len;
			}

			end_of_input = true;

			break;
		}

		/* Echo received characters */
		shell_fprintf(sh, SHELL_NORMAL, "%c", *p);
	}

	switch (ctx->content_format) {
	case BYPASS_CONTENT_FORMAT_TEXT:
		err = bypass_consume_text(sh, ctx, data, len);
		break;
	case BYPASS_CONTENT_FORMAT_BASE64:
		err = bypass_consume_base64(sh, ctx, data, len);
		break;
	default:
		err = -EINVAL;
		break;
	}

	if (err) {
		bypass_finish(sh, ctx);
		return;
	}

	if (end_of_input) {
		err = tls_credential_add(ctx->tag, ctx->type, ctx->data, ctx->len);
		if (err) {
			shell_error(sh, "Failed to add credential: %d", err);
			free(ctx->data);
		}

		/*
		 * FIXME: this leaks heap area allocated for TLS credential. Such area should be
		 * tracked, so that next time TLS credential with the same tag and type gets
		 * assigned, old area can be safely deallocated.
		 */
		ctx->data = NULL;

		bypass_finish(sh, ctx);
	}
}

static int bypass_content_type_from_str(const char *str,
					enum bypass_content_format *content_format)
{
	for (const struct bypass_content_format_info *info = bypass_content_formats;
	     info < &bypass_content_formats[ARRAY_SIZE(bypass_content_formats)];
	     info++) {
		if (!strcmp(info->name, str)) {
			*content_format = info->content_format;
			return 0;
		}
	}

	return -EINVAL;
}

static int cmd_tls_credential_add_parse_argv_options(const struct shell *sh,
						     size_t *argc, char ***argv,
						     enum bypass_content_format *content_format)
{
	struct getopt_state *state;
	int err;
	int c;

	while ((c = getopt(*argc, *argv, "t:")) != -1) {
		state = getopt_state_get();
		switch (c) {
		case 't':
			err = bypass_content_type_from_str(state->optarg,
							   content_format);
			if (err) {
				return err;
			}
			break;
		case 'h':
			/* When getopt is active shell is not parsing
			 * command handler to print help message. It must
			 * be done explicitly.
			 */
			shell_help(sh);
			return SHELL_CMD_HELP_PRINTED;
		default:
			shell_help(sh);
			return SHELL_CMD_HELP_PRINTED;
		}
	}

	state = getopt_state_get();

	*argv += state->optind;
	*argc -= state->optind;

	return 0;
}

static int cmd_tls_credential_pasrse_tag_and_type(const struct shell *sh,
						  char **argv,
						  long *tag,
						  enum tls_credential_type *type)
{
	const char *tag_s = argv[0];
	const char *type_s = argv[1];

	*tag = strtol(tag_s, NULL, 0);

	*type = tls_credential_str_to_type(type_s);
	if (*type == TLS_CREDENTIAL_NONE) {
		shell_error(sh, "Invalid credential type specified (%s)", type_s);
		return -EINVAL;
	}

	return 0;
}

static int cmd_tls_credential_add_parse_argv_positional(const struct shell *sh,
							size_t argc, char **argv,
							long *tag,
							enum tls_credential_type *type,
							void **value, size_t *value_len)
{
	int err;

	err = cmd_tls_credential_pasrse_tag_and_type(sh, argv, tag, type);
	if (err) {
		return err;
	}

	*value = NULL;

	if (argc > 2) {
		/* Parse credential directly from argument (handy for PSK-ID/PSK) */
		const void *val = argv[2];
		size_t len = strlen(val);

		*value = malloc(len);
		if (!(*value)) {
			shell_error(sh, "Not enough memory");
			return -ENOMEM;
		}

		memcpy(*value, val, len);
		*value_len = len;
	}

	return 0;
}

static int cmd_tls_credential_add(const struct shell *sh, size_t argc, char **argv)
{
	long tag;
	enum tls_credential_type type;
	void *value;
	size_t value_len;
	enum bypass_content_format content_format = BYPASS_CONTENT_FORMAT_TEXT;
	int ret;
	int err;

	ret = cmd_tls_credential_add_parse_argv_options(sh, &argc, &argv, &content_format);
	if (ret != 0) {
		return ret;
	}

	if (argc < 2) {
		shell_error(sh, "wrong parameter count");
		return -EINVAL;
	}

	ret = cmd_tls_credential_add_parse_argv_positional(sh, argc, argv,
							   &tag, &type,
							   &value, &value_len);
	if (ret != 0) {
		return ret;
	}

	if (value) {
		/*
		 * FIXME: this leaks heap area allocated for TLS credential (stored in 'value').
		 * Such area should be tracked, so that next time TLS credential with the same tag
		 * and type gets assigned, old area can be safely deallocated.
		 */
		err = tls_credential_add(tag, type, value, value_len);
		if (err) {
			shell_error(sh, "Failed to add credential: %d", err);
		}
		return err;
	}

	/* Parse from shell input */
	shell_bypass_context.tag = tag;
	shell_bypass_context.type = type;
	shell_bypass_context.content_format = content_format;
	shell_bypass_context.base64_buf_len = 0;
	shell_set_bypass(sh, bypass_cb);

	return 0;
}

static int cmd_tls_credential_delete(const struct shell *sh, size_t argc, char **argv)
{
	long tag;
	enum tls_credential_type type;
	int err;

	err = cmd_tls_credential_pasrse_tag_and_type(sh, &argv[1], &tag, &type);
	if (err) {
		return err;
	}

	err = tls_credential_delete(tag, type);
	if (err) {
		shell_error(sh, "Failed to delete credential: %d", err);
		return err;
	}

	return 0;
}

SHELL_STATIC_SUBCMD_SET_CREATE(cmds_tls_credential,
	SHELL_CMD(add, NULL,
		"add [-t text|base64] <tag> <type> [value]",
		cmd_tls_credential_add),
	SHELL_CMD_ARG(delete, NULL,
		"delete <tag> <type>",
		cmd_tls_credential_delete, 3, 0),
	SHELL_SUBCMD_SET_END
);

SHELL_CMD_REGISTER(tls_credential, &cmds_tls_credential, "TLS credential shell", NULL);
```
