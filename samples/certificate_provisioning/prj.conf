## CMakeLists.txt
```
# SPDX-License-Identifier: Apache-2.0

cmake_minimum_required(VERSION 3.20.0)

find_package(Zephyr REQUIRED HINTS $ENV{ZEPHYR_BASE})
project(certificate_provisioning)

target_sources(app PRIVATE src/main.c)
```

## Kconfig
```
# Copyright (c) 2023 Golioth, Inc.
# SPDX-License-Identifier: Apache-2.0

mainmenu "Golioth application options"

config NET_BUF_TX_COUNT
	default 32 if GOLIOTH_AUTH_METHOD_CERT && WIFI_ESP_AT

source "Kconfig.zephyr"
```

## sample.yaml
```
sample:
  description: Provision certificates onto a device
  name: certificate_provisioning
common:
  tags: golioth socket goliothd
tests:
  sample.golioth.certificate_provisioning:
    build_only: true
    platform_allow: >
      esp32_devkitc_wroom
      nrf9160dk_nrf9160_ns
      qemu_x86
```

## prj.conf
```kconfig
CONFIG_GOLIOTH_SAMPLES_COMMON=y

# Application
CONFIG_LOG_BACKEND_GOLIOTH=y

# Enable flash operations
CONFIG_FLASH=y
CONFIG_FLASH_MAP=y

# Enable the LittleFS file system
CONFIG_FILE_SYSTEM=y
CONFIG_FILE_SYSTEM_LITTLEFS=y
CONFIG_FILE_SYSTEM_SHELL=y
CONFIG_HEAP_MEM_POOL_SIZE=4096

# Add 256 bytes to accommodate upload command (lfs_stat overflows)
CONFIG_SYSTEM_WORKQUEUE_STACK_SIZE=2304

# Enable mcumgr
CONFIG_ZCBOR=y
CONFIG_MCUMGR=y

# Enable console with mcumgr pass through
CONFIG_CONSOLE=y
CONFIG_UART_CONSOLE=y
CONFIG_UART_CONSOLE_MCUMGR=y

# Enable the shell mcumgr transport. This allows SMP messages to pass
# through the shell to the mgmt subsystem.
CONFIG_SHELL=y
CONFIG_SHELL_BACKEND_SERIAL=y
CONFIG_BASE64=y
CONFIG_MCUMGR_TRANSPORT_SHELL=y

# Enable file system commands
CONFIG_MCUMGR_GRP_FS=y

# Enable shell commands over SMP
CONFIG_SHELL_BACKEND_DUMMY=y
CONFIG_MCUMGR_GRP_SHELL=y

# Some mgmt command handlers require a large stack.
CONFIG_SYSTEM_WORKQUEUE_STACK_SIZE=2304
CONFIG_MAIN_STACK_SIZE=2048

# Enable certificate authentication. Do not use hardcoded credentials.
CONFIG_GOLIOTH_AUTH_METHOD_CERT=y
CONFIG_GOLIOTH_SAMPLE_HARDCODED_CREDENTIALS=n
```

## boards/nrf52840dk_nrf52840.conf
```kconfig
# WiFi
CONFIG_WIFI=y
CONFIG_WIFI_ESP_AT=y
CONFIG_WIFI_ESP_AT_MDM_RX_BUF_COUNT=40

CONFIG_NET_L2_WIFI_SHELL=y
CONFIG_GOLIOTH_SAMPLE_WIFI=y

# Allow reboot from shell after loading certificates
CONFIG_REBOOT=y
```

## boards/nrf9160dk_nrf9160_ns.conf
```kconfig
#
# Copyright (c) 2021 Golioth, Inc.
#
# SPDX-License-Identifier: Apache-2.0

# General config
CONFIG_HEAP_MEM_POOL_SIZE=4096
CONFIG_NEWLIB_LIBC=y

# Networking
CONFIG_NET_SOCKETS_OFFLOAD=y
CONFIG_NET_IPV6=y
CONFIG_NET_IPV6_NBR_CACHE=n
CONFIG_NET_IPV6_MLD=n

# Increase native TLS socket implementation, so that it is chosen instead of
# offloaded nRF91 sockets
CONFIG_NET_SOCKETS_TLS_PRIORITY=35

# Modem library
CONFIG_NRF_MODEM_LIB=y
CONFIG_NRF_MODEM_LIB_ON_FAULT_APPLICATION_SPECIFIC=y

# LTE connectivity with network connection manager
CONFIG_LTE_CONNECTIVITY=y
CONFIG_NET_CONNECTION_MANAGER=y
CONFIG_NET_CONNECTION_MANAGER_MONITOR_STACK_SIZE=1024

# Increased sysworkq size, due to LTE connectivity
CONFIG_SYSTEM_WORKQUEUE_STACK_SIZE=2048

# Disable options y-selected by NCS for no good reason
CONFIG_MBEDTLS_KEY_EXCHANGE_DHE_PSK_ENABLED=n
CONFIG_MBEDTLS_KEY_EXCHANGE_DHE_RSA_ENABLED=n
```

## boards/qemu_x86.conf
```kconfig
# Kernel options
CONFIG_ENTROPY_GENERATOR=y
CONFIG_TEST_RANDOM_GENERATOR=y
CONFIG_HEAP_MEM_POOL_SIZE=4096

# Static networking
CONFIG_NET_CONFIG_LOG_LEVEL_DBG=y
CONFIG_NET_CONFIG_SETTINGS=y
CONFIG_NET_CONFIG_NEED_IPV4=y
CONFIG_NET_CONFIG_MY_IPV4_ADDR="192.0.2.1"
CONFIG_NET_CONFIG_MY_IPV4_GW="192.0.2.2"
CONFIG_NET_CONFIG_PEER_IPV4_ADDR="192.0.2.2"
```

## src/main.c
```c
/*
 * Copyright (c) 2021 Golioth, Inc.
 *
 * SPDX-License-Identifier: Apache-2.0
 */

#include <zephyr/logging/log.h>
LOG_MODULE_REGISTER(cert_provisioning, LOG_LEVEL_DBG);

#include <net/golioth/system_client.h>
#include <samples/common/net_connect.h>
#include <zephyr/net/coap.h>
#include <zephyr/device.h>
#include <zephyr/fs/fs.h>
#include <zephyr/fs/littlefs.h>

#define CLIENT_CERTIFICATE_PATH "/lfs1/credentials/client_cert.der"
#define PRIVATE_KEY_PATH        "/lfs1/credentials/private_key.der"

#define STORAGE_PARTITION_LABEL	storage_partition
#define STORAGE_PARTITION_ID	FIXED_PARTITION_ID(STORAGE_PARTITION_LABEL)

FS_LITTLEFS_DECLARE_DEFAULT_CONFIG(cstorage);
static struct fs_mount_t littlefs_mnt = {
	.type = FS_LITTLEFS,
	.fs_data = &cstorage,
	.storage_dev = (void *)STORAGE_PARTITION_ID,
	.mnt_point = "/lfs1"
};

static struct golioth_client *client = GOLIOTH_SYSTEM_CLIENT_GET();

static K_SEM_DEFINE(connected, 0, 1);

static void golioth_on_connect(struct golioth_client *client)
{
	k_sem_give(&connected);
}

static int load_credential_from_fs(const char *path, enum tls_credential_type type)
{
	struct fs_file_t file;
	struct fs_dirent dirent;

	fs_file_t_init(&file);

	int err = fs_stat(path, &dirent);

	if (err < 0) {
		LOG_WRN("Could not stat %s, err: %d", path, err);
		goto finish;
	}
	if (dirent.type != FS_DIR_ENTRY_FILE) {
		LOG_ERR("%s is not a file", path);
		err = -EISDIR;
		goto finish;
	}
	if (dirent.size == 0) {
		LOG_ERR("%s is an empty file", path);
		err = -EINVAL;
		goto finish;
	}


	err = fs_open(&file, path, FS_O_READ);

	if (err < 0) {
		LOG_ERR("Could not open %s", path);
		goto finish;
	}

	/* NOTE: cred_buf is used directly by the TLS Credentials library, and so must remain
	 * allocated for the life of the program.
	 */

	void *cred_buf = malloc(dirent.size);

	if (cred_buf == NULL) {
		LOG_ERR("Could not allocate space to read credential");
		err = -ENOMEM;
		goto finish_with_file;
	}

	err = fs_read(&file, cred_buf, dirent.size);

	if (err < 0) {
		LOG_ERR("Could not read %s, err: %d", path, err);
		free(cred_buf);
		goto finish_with_file;
	}

	LOG_INF("Read %d bytes from %s", err, path);

	/* Write to credential store */

	err = tls_credential_add(CONFIG_GOLIOTH_SYSTEM_CLIENT_CREDENTIALS_TAG,
				 type,
				 cred_buf, err);

	if (err < 0) {
		LOG_ERR("Could not load credential, err: %d", err);
		free(cred_buf);
	}

finish_with_file:
	fs_close(&file);

finish:
	return err;
}

int main(void)
{
	int err;

	LOG_DBG("Start certificate provisioning sample");

	err = fs_mount(&littlefs_mnt);
	if (err < 0) {
		LOG_ERR("Error mounting littlefs [%d]", err);
	}

	load_credential_from_fs(CLIENT_CERTIFICATE_PATH, TLS_CREDENTIAL_SERVER_CERTIFICATE);
	load_credential_from_fs(PRIVATE_KEY_PATH, TLS_CREDENTIAL_PRIVATE_KEY);

	net_connect();

	client->on_connect = golioth_on_connect;
	golioth_system_client_start();

	k_sem_take(&connected, K_FOREVER);

	int counter = 0;

	while (true) {
		k_sleep(K_SECONDS(5));
		LOG_INF("Sending hello! %d", counter);
		++counter;
	}

	return 0;
}
```
