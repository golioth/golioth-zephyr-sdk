## CMakeLists.txt
```
# SPDX-License-Identifier: Apache-2.0

cmake_minimum_required(VERSION 3.20.0)

find_package(Zephyr REQUIRED HINTS $ENV{ZEPHYR_BASE})
project(libcoap_hello)

target_sources(app PRIVATE src/main.c)
```

## prj.conf
```kconfig
CONFIG_GOLIOTH_SAMPLES_COMMON=y

# Generic networking options
CONFIG_NETWORKING=y
CONFIG_NET_IPV4=y
CONFIG_NET_IPV6=n

# Logging
CONFIG_NET_LOG=y

# Network Shell
CONFIG_NET_SHELL=y

# TLS configuration
CONFIG_MBEDTLS_ENABLE_HEAP=y
CONFIG_MBEDTLS_HEAP_SIZE=20480
CONFIG_MBEDTLS_SSL_MAX_CONTENT_LEN=8192

# Application
CONFIG_MAIN_STACK_SIZE=8192

# Golioth specific stuff
CONFIG_MBEDTLS=y
CONFIG_MBEDTLS_DTLS=y
CONFIG_NET_SOCKETS=y
CONFIG_NET_UDP=y

# Optional for some targets
CONFIG_DNS_RESOLVER=y
CONFIG_NET_SOCKETS_SOCKOPT_TLS=y
CONFIG_NET_SOCKETS_ENABLE_DTLS=y

# Authentication based options
CONFIG_MBEDTLS_KEY_EXCHANGE_PSK_ENABLED=y
CONFIG_MBEDTLS_CIPHER_GCM_ENABLED=y

# Misc, to be verified if needed
CONFIG_EVENTFD=y

# libcoap
CONFIG_LIBCOAP=y
```

## boards/nrf9160dk_nrf9160_ns.conf
```kconfig
#
# Copyright (c) 2021 Golioth, Inc.
#
# SPDX-License-Identifier: Apache-2.0

# General config
CONFIG_HEAP_MEM_POOL_SIZE=4096
CONFIG_NEWLIB_LIBC=y

# Networking
CONFIG_NET_NATIVE=n
CONFIG_NET_SOCKETS_OFFLOAD=y

# Increase native TLS socket implementation, so that it is chosen instead of
# offloaded nRF91 sockets
CONFIG_NET_SOCKETS_TLS_PRIORITY=35

# LTE link control
CONFIG_LTE_LINK_CONTROL=y
CONFIG_LTE_AUTO_INIT_AND_CONNECT=y

# Modem library
CONFIG_NRF_MODEM_LIB=y

# Use NCS fork of mbedTLS, as Zephyr built-in mbedTLS integration (CONFIG_MBEDTLS_BUILTIN) is in
# conflict with CONFIG_NRF_SECURITY
CONFIG_MBEDTLS_TLS_LIBRARY=y
CONFIG_MBEDTLS_SSL_PROTO_DTLS=y
CONFIG_MBEDTLS_GCM_C=y
# ... and disable options y-selected by NCS for no good reason
CONFIG_MBEDTLS_KEY_EXCHANGE_DHE_PSK_ENABLED=n
CONFIG_MBEDTLS_KEY_EXCHANGE_DHE_RSA_ENABLED=n
# ... also increase heap size to "high enough to make it work"
CONFIG_MBEDTLS_HEAP_SIZE=49152
```

## src/main.c
```c
/*
 * Copyright (c) 2022 Golioth, Inc.
 *
 * SPDX-License-Identifier: Apache-2.0
 */

#include <zephyr/logging/log.h>
LOG_MODULE_REGISTER(libcoap_hello, LOG_LEVEL_DBG);

#include <zephyr/kernel.h>

#include <samples/common/net_connect.h>

void main(void)
{
	int counter = 0;

	LOG_DBG("Start libcoap hello sample");

	if (IS_ENABLED(CONFIG_GOLIOTH_SAMPLES_COMMON)) {
		net_connect();
	}

	while (true) {
		LOG_INF("Sending hello! %d", counter);

		LOG_WRN("TODO: golioth_send_hello() implement");

		++counter;
		k_sleep(K_SECONDS(5));
	}
}
```
