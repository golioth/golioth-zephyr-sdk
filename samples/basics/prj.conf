## CMakeLists.txt
```
# SPDX-License-Identifier: Apache-2.0

cmake_minimum_required(VERSION 3.20.0)

find_package(Zephyr REQUIRED HINTS $ENV{ZEPHYR_BASE})
project(hello)

target_sources(app PRIVATE
  src/main.c
  src/lightdb_helpers.c
)

target_sources_ifdef(CONFIG_BOOTLOADER_MCUBOOT app PRIVATE
  src/dfu.c
  src/flash.c
)
```

## Kconfig
```
# Copyright (c) 2021 Golioth, Inc.
# SPDX-License-Identifier: Apache-2.0

mainmenu "Golioth application options"

if DNS_RESOLVER

config DNS_SERVER_IP_ADDRESSES
	default y

config DNS_SERVER1
	default "1.1.1.1"

endif # DNS_RESOLVER

config NET_BUF_TX_COUNT
	default 32 if GOLIOTH_AUTH_METHOD_CERT && WIFI_ESP_AT

if SETTINGS

config SETTINGS_RUNTIME
	default y

config GOLIOTH_SAMPLE_SETTINGS_AUTOLOAD
	default y

config GOLIOTH_SAMPLE_SETTINGS_SHELL
	default y

endif # SETTINGS

source "Kconfig.zephyr"
```

## prj.conf
```kconfig
CONFIG_GOLIOTH_SAMPLES_COMMON=y

# Generic networking options
CONFIG_NETWORKING=y
CONFIG_NET_IPV4=y
CONFIG_NET_IPV6=n
CONFIG_NET_PKT_TX_COUNT=8

# Logging
CONFIG_NET_LOG=y

# Network Shell
CONFIG_NET_SHELL=y

# TLS configuration
CONFIG_MBEDTLS_ENABLE_HEAP=y
CONFIG_MBEDTLS_HEAP_SIZE=10240
CONFIG_MBEDTLS_SSL_MAX_CONTENT_LEN=2048

# Application
CONFIG_MAIN_STACK_SIZE=4096

CONFIG_GOLIOTH=y
CONFIG_GOLIOTH_FW=y
CONFIG_GOLIOTH_SYSTEM_CLIENT=y

CONFIG_MINIMAL_LIBC_MALLOC_ARENA_SIZE=2560

CONFIG_LOG_PROCESS_THREAD_STACK_SIZE=2048

CONFIG_GOLIOTH_RPC=y
CONFIG_GOLIOTH_SETTINGS=y

CONFIG_FLASH=y
CONFIG_FLASH_MAP=y
CONFIG_NVS=y
CONFIG_STREAM_FLASH=y
CONFIG_IMG_MANAGER=y
CONFIG_IMG_ERASE_PROGRESSIVELY=y
CONFIG_REBOOT=y
```

## overlay-minimal-nrf52840dk.conf
```kconfig
# Disable printk, logging and shell
CONFIG_BOOT_BANNER=n
CONFIG_PRINTK=n

CONFIG_UART_CONSOLE=n
CONFIG_CONSOLE=n
CONFIG_USE_SEGGER_RTT=n

CONFIG_NET_SHELL=n
CONFIG_NET_L2_WIFI_SHELL=n

CONFIG_LOG_BACKEND_GOLIOTH=n
CONFIG_NET_LOG=n
CONFIG_LOG=n

# Disable floating point
CONFIG_CBPRINTF_FP_SUPPORT=n
CONFIG_CBPRINTF_NANO=y

# Trim down mbedTLS features/resources
CONFIG_MBEDTLS_KEY_EXCHANGE_RSA_ENABLED=n
CONFIG_MBEDTLS_HASH_SHA384_ENABLED=n
CONFIG_MBEDTLS_HASH_SHA512_ENABLED=n
CONFIG_MBEDTLS_MAC_MD5_ENABLED=n
CONFIG_MBEDTLS_MAC_SHA1_ENABLED=n
CONFIG_MBEDTLS_CIPHER_DES_ENABLED=n
CONFIG_MBEDTLS_CIPHER_MODE_CBC_ENABLED=n
CONFIG_MBEDTLS_SSL_MAX_CONTENT_LEN=1152
CONFIG_MBEDTLS_HEAP_SIZE=5632

# Thread stack sizes (based on `kernel stacks` output)
CONFIG_MAIN_STACK_SIZE=1024
CONFIG_ISR_STACK_SIZE=448
CONFIG_IDLE_STACK_SIZE=96
CONFIG_NET_MGMT_EVENT_STACK_SIZE=256
CONFIG_SYSTEM_WORKQUEUE_STACK_SIZE=192
CONFIG_NET_RX_STACK_SIZE=160
CONFIG_GOLIOTH_SYSTEM_CLIENT_STACK_SIZE=2176
CONFIG_WIFI_ESP_AT_WORKQ_STACK_SIZE=512
CONFIG_WIFI_ESP_AT_RX_STACK_SIZE=512

# Reduce ESP-AT WiFi driver buffers
CONFIG_WIFI_ESP_AT_MDM_RING_BUF_SIZE=128
CONFIG_WIFI_ESP_AT_MDM_RX_BUF_COUNT=10

# Networking stack buffers/packets
CONFIG_NET_PKT_TX_COUNT=8
CONFIG_NET_BUF_RX_COUNT=9
CONFIG_NET_BUF_TX_COUNT=7
CONFIG_NET_MAX_CONN=2
CONFIG_NET_MAX_CONTEXTS=2
CONFIG_NET_IF_MCAST_IPV4_ADDR_COUNT=0

# Reduce heap usage
CONFIG_MINIMAL_LIBC_MALLOC_ARENA_SIZE=2560
```

## overlay-minimal-nrf9160dk.conf
```kconfig
# Disable printk, logging and shell
CONFIG_BOOT_BANNER=n
CONFIG_PRINTK=n

CONFIG_UART_CONSOLE=n
CONFIG_CONSOLE=n
CONFIG_USE_SEGGER_RTT=n

CONFIG_UART_NRFX=n

# CONFIG_SHELL=y
CONFIG_NET_SHELL=n

CONFIG_LOG_BACKEND_GOLIOTH=n
CONFIG_NET_LOG=n
CONFIG_LOG=n

# Disable floating point
CONFIG_CBPRINTF_FP_SUPPORT=n
CONFIG_CBPRINTF_NANO=y

# Thread stack sizes (based on `kernel stacks` output)
CONFIG_MAIN_STACK_SIZE=1088
CONFIG_ISR_STACK_SIZE=448
CONFIG_IDLE_STACK_SIZE=96
CONFIG_SYSTEM_WORKQUEUE_STACK_SIZE=768
CONFIG_GOLIOTH_SYSTEM_CLIENT_STACK_SIZE=2176

# Disable unused mbedTLS heap
CONFIG_MBEDTLS_ENABLE_HEAP=n

# Reduce kernel heap
CONFIG_HEAP_MEM_POOL_SIZE=1024
```

## overlay-minimal.conf
```kconfig
CONFIG_NET_SHELL=n
# CONFIG_SHELL=y
# CONFIG_MBEDTLS_SHELL=y
# CONFIG_MBEDTLS_MEMORY_DEBUG=y
CONFIG_NET_L2_WIFI_SHELL=n

CONFIG_UART_CONSOLE=n
CONFIG_CONSOLE=n
CONFIG_USE_SEGGER_RTT=n

CONFIG_LOG_BACKEND_GOLIOTH=n
CONFIG_NET_LOG=n
CONFIG_LOG=n

CONFIG_CBPRINTF_FP_SUPPORT=n
CONFIG_CBPRINTF_NANO=y

CONFIG_MBEDTLS_KEY_EXCHANGE_RSA_ENABLED=n
CONFIG_MBEDTLS_HASH_SHA384_ENABLED=n
CONFIG_MBEDTLS_HASH_SHA512_ENABLED=n
CONFIG_MBEDTLS_MAC_MD5_ENABLED=n
CONFIG_MBEDTLS_MAC_SHA1_ENABLED=n
CONFIG_MBEDTLS_CIPHER_DES_ENABLED=n
CONFIG_MBEDTLS_CIPHER_MODE_CBC_ENABLED=n
CONFIG_MBEDTLS_SSL_MAX_CONTENT_LEN=256
CONFIG_MBEDTLS_HEAP_SIZE=4096

CONFIG_MAIN_STACK_SIZE=1024
CONFIG_ISR_STACK_SIZE=512
CONFIG_IDLE_STACK_SIZE=96
CONFIG_NET_MGMT_EVENT_STACK_SIZE=192
CONFIG_SYSTEM_WORKQUEUE_STACK_SIZE=256
CONFIG_NET_RX_STACK_SIZE=192
CONFIG_GOLIOTH_SYSTEM_CLIENT_STACK_SIZE=2048
CONFIG_WIFI_ESP_AT_WORKQ_STACK_SIZE=512
CONFIG_WIFI_ESP_AT_RX_STACK_SIZE=512

CONFIG_WIFI_ESP_AT_MDM_RING_BUF_SIZE=128
CONFIG_WIFI_ESP_AT_MDM_RX_BUF_SIZE=64
CONFIG_WIFI_ESP_AT_MDM_RX_BUF_COUNT=4

CONFIG_NET_BUF_DATA_SIZE=64
CONFIG_NET_PKT_RX_COUNT=2
CONFIG_NET_PKT_TX_COUNT=2
CONFIG_NET_BUF_RX_COUNT=8
CONFIG_NET_BUF_TX_COUNT=8
CONFIG_NET_MAX_CONN=2
CONFIG_NET_MAX_CONTEXTS=2
CONFIG_NET_IF_MCAST_IPV4_ADDR_COUNT=0
CONFIG_MINIMAL_LIBC_MALLOC_ARENA_SIZE=1024
```

## boards/nrf9160dk_nrf9160_ns.conf
```kconfig
# General config
CONFIG_HEAP_MEM_POOL_SIZE=4096
CONFIG_NEWLIB_LIBC=y

# Networking
CONFIG_NET_NATIVE=n
CONFIG_NET_SOCKETS_OFFLOAD=y

# LTE link control
CONFIG_LTE_LINK_CONTROL=y
CONFIG_LTE_AUTO_INIT_AND_CONNECT=y

# Modem library
CONFIG_NRF_MODEM_LIB=y

# Generate MCUboot compatible images
CONFIG_BOOTLOADER_MCUBOOT=y
```

## src/main.c
```c
/*
 * Copyright (c) 2021-2023 Golioth, Inc.
 *
 * SPDX-License-Identifier: Apache-2.0
 */

#include <zephyr/logging/log.h>
LOG_MODULE_REGISTER(golioth_basics, LOG_LEVEL_DBG);

#include <net/golioth/system_client.h>
#include <net/golioth/rpc.h>
#include <samples/common/net_connect.h>
#include <zephyr/net/coap.h>

#include <qcbor/posix_error_map.h>
#include <qcbor/qcbor.h>
#include <qcbor/qcbor_spiffy_decode.h>

#include "dfu.h"
#include "lightdb_helpers.h"

static struct golioth_client *client = GOLIOTH_SYSTEM_CLIENT_GET();

/* Configurable via LightDB State at path "desired/my_config" */
static int32_t _my_config = 0;

/* Configurable via Settings service, key = "LOOP_DELAY_S" */
static int32_t _loop_delay_s = 10;

static K_SEM_DEFINE(connected, 0, 1);

static int on_loop_delay_setting(int32_t new_value)
{
	LOG_INF("Setting loop delay to %" PRId32 " s", new_value);

	_loop_delay_s = new_value;

	return 0;
}

enum golioth_settings_status on_setting(const char *key,
					const struct golioth_settings_value *value)
{
	LOG_DBG("Received setting: key = %s, type = %d", key, value->type);
	if (strcmp(key, "LOOP_DELAY_S") == 0) {
		/* This setting is expected to be numeric, return an error if it's not */
		if (value->type != GOLIOTH_SETTINGS_VALUE_TYPE_INT64) {
			return GOLIOTH_SETTINGS_VALUE_FORMAT_NOT_VALID;
		}

		/* Setting has passed all checks, so apply it to the loop delay */
		(void)on_loop_delay_setting(value->i64);

		return GOLIOTH_SETTINGS_SUCCESS;
	}

	/* If the setting is not recognized, we should return an error */
	return GOLIOTH_SETTINGS_KEY_NOT_RECOGNIZED;
}

static enum golioth_rpc_status on_multiply(QCBORDecodeContext *request_params_array,
					   QCBOREncodeContext *response_detail_map,
					   void *callback_arg)
{
	double a, b;
	int64_t value;
	QCBORError qerr;

	QCBORDecode_GetDouble(request_params_array, &a);
	QCBORDecode_GetDouble(request_params_array, &b);
	qerr = QCBORDecode_GetError(request_params_array);
	if (qerr != QCBOR_SUCCESS) {
		LOG_ERR("Failed to decode array items: %d (%s)", qerr, qcbor_err_to_str(qerr));
		return GOLIOTH_RPC_INVALID_ARGUMENT;
	}

	value = a * b;
	QCBOREncode_AddInt64ToMap(response_detail_map, "value", value);
	return GOLIOTH_RPC_OK;
}

static int golioth_req_rsp_as_cbor_int64(struct golioth_req_rsp *rsp, int64_t *value)
{
	QCBORDecodeContext dec;
	QCBORError qerr;
	UsefulBufC payload_buf = { rsp->data, rsp->len };

	QCBORDecode_Init(&dec, payload_buf, QCBOR_DECODE_MODE_NORMAL);
	QCBORDecode_GetInt64(&dec, value);
	qerr = QCBORDecode_GetError(&dec);
	if (qerr != QCBOR_SUCCESS) {
		LOG_ERR("Failed to parse int64_t: %d (%s)",
			qerr, qcbor_err_to_str(qerr));
		QCBORDecode_Finish(&dec);
		return qcbor_error_to_posix(qerr);
	}

	return 0;
}

static int on_get_my_int(struct golioth_req_rsp *rsp)
{
	const char *path = rsp->user_data;
	int64_t value;
	int err;

	if (rsp->err) {
		LOG_ERR("Failed to receive %s value: %d", path, rsp->err);
		return rsp->err;
	}

	err = golioth_req_rsp_as_cbor_int64(rsp, &value);
	if (err) {
		LOG_ERR("Failed to parse '%s': %d", path, err);
		return err;
	}

	LOG_INF("Callback got %s = %" PRId64, path, value);

	return 0;
}

static int on_my_config(struct golioth_req_rsp *rsp)
{
	const char *path = rsp->user_data;
	int64_t desired_value;
	int err;

	if (rsp->err) {
		LOG_ERR("Failed to receive '%s' value: %d", path, rsp->err);
		return rsp->err;
	}

	err = golioth_req_rsp_as_cbor_int64(rsp, &desired_value);
	if (err) {
		LOG_ERR("Failed to parse '%s': %d", path, err);
		return err;
	}

	LOG_INF("Cloud desires %s = %" PRId64 ". Setting now.",
		path, desired_value);

	_my_config = desired_value;

	err = golioth_lightdb_delete_cb(client, path, NULL, NULL);
	if (err) {
		LOG_WRN("Failed to delete '%s' from LightDB: %d", path, err);
	}

	return 0;
}

static void golioth_on_connect(struct golioth_client *client)
{
	int err;

	LOG_INF("Golioth client %s", "connected");

	k_sem_give(&connected);

	err = golioth_rpc_observe(client);
	if (err) {
		LOG_ERR("Failed to observe RPC: %d", err);
	}

	err = golioth_settings_observe(client);
	if (err) {
		LOG_ERR("Failed to observe settings: %d", err);
	}

	err = golioth_lightdb_observe_cb(client, "desired/my_config",
					 GOLIOTH_CONTENT_FORMAT_APP_CBOR,
					 on_my_config, "desired/my_config");
	if (err) {
		LOG_ERR("Failed to observe LightDB path: %d", err);
	}

	dfu_on_connect(client);
}

static void counter_set_async(int counter)
{
	char sbuf[sizeof("4294967295")];
	int err;

	snprintk(sbuf, sizeof(sbuf) - 1, "%d", counter);

	err = golioth_lightdb_set_cb(client, "counter",
				     GOLIOTH_CONTENT_FORMAT_APP_JSON,
				     sbuf, strlen(sbuf),
				     NULL, NULL);
	if (err) {
		LOG_WRN("Failed to set counter: %d", err);
		return;
	}
}

void main(void)
{
	int counter = 0;
	int err;

	LOG_DBG("Start Hello sample");

	if (IS_ENABLED(CONFIG_GOLIOTH_SAMPLES_COMMON)) {
		net_connect();
	}

	client->on_connect = golioth_on_connect;
	golioth_system_client_start();

	err = golioth_rpc_register(client, "multiply", on_multiply, NULL);
	if (err) {
		LOG_ERR("Failed to register 'multiply' RPC method: %d", err);
	}

	err = golioth_settings_register_callback(client, on_setting);
	if (err) {
		LOG_ERR("Failed to register settings callback: %d", err);
	}

	k_sem_take(&connected, K_FOREVER);

	LOG_INF("Hello, Golioth!");

	// For OTA, we will spawn a background task that will listen for firmware
	// updates from Golioth and automatically update firmware on the device
	/* NOTE: this is done in dfu_main() */

	// There are a number of different functions you can call to get and set values in
	// LightDB state, based on the type of value (e.g. int, bool, float, string, JSON).
	//
	// This is an "asynchronous" function, meaning that the function will return
	// immediately and the integer will be sent to Golioth at a later time.
	// Internally, the request is added to a queue which is processed
	// by the Golioth client task.
	//
	// Any functions provided by this SDK ending in _async behave the same way.
	//
	// The last two arguments are for an optional callback function and argument,
	// in case the user wants to be notified when the set request has completed
	// and received acknowledgement from the Golioth server. In this case
	// we set them to NULL, which makes this a "fire-and-forget" request.
	err = golioth_lightdb_set_cb(client, "my_int",
				     GOLIOTH_CONTENT_FORMAT_APP_JSON,
				     "42", sizeof("42") - 1,
				     NULL, NULL);
	if (err) {
		LOG_WRN("Failed to set '%s': %d", "my_int", err);
	}

	// We can also send requests "synchronously", meaning the function will block
	// until one of 3 things happen (whichever comes first):
	//
	//  1. We receive a response to the request from the server
	//  2. The user-provided timeout expires
	//  3. The default client task timeout expires (GOLIOTH_COAP_RESPONSE_TIMEOUT_S)
	//
	// In this case, we will block for up to 2 seconds waiting for the server response.
	// We'll check the return code to know whether a timeout happened.
	//
	// Any function provided by this SDK ending in _sync will have the same meaning.
	err = golioth_lightdb_set(client, "my_string",
				  GOLIOTH_CONTENT_FORMAT_APP_JSON,
				  "\"asdf\"", sizeof("\"asdf\"") - 1);
	if (err) {
		LOG_ERR("Error setting string: %d", err);
	}

	// Read back the integer we set above
	int32_t readback_int = 0;
	err = golioth_lightdb_get_auto(client, "my_int", &readback_int);
	if (err) {
		LOG_ERR("Synchronous get my_int failed: %d", err);
	} else {
		LOG_INF("Synchronously got my_int = %" PRId32, readback_int);
	}

	// To asynchronously get a value from LightDB, a callback function must be provided
	err = golioth_lightdb_get_cb(client, "my_int",
				     GOLIOTH_CONTENT_FORMAT_APP_CBOR,
				     on_get_my_int, "my_int");
	if (err) {
		LOG_WRN("Failed to get data from LightDB: %d", err);
	}

	// We can also "observe" paths in LightDB state. The Golioth cloud will notify
	// our client whenever the resource at that path changes, without needing
	// to poll.
	//
	// This can be used to implement the "digital twin" concept that is common in IoT.
	//
	// In this case, we will observe the path desired/my_config for changes.
	// The callback will read the value, update it locally, then delete the path
	// to indicate that the desired state was processed (the "twins" should be
	// in sync at that point).
	//
	// If you want to try this out, log into Golioth console (console.golioth.io),
	// go to the "LightDB State" tab, and add a new item for desired/my_config.
	// Once set, the on_my_config callback function should be called here.
	/* NOTE: this is done in client->on_connect() */

	// LightDB Stream functions are nearly identical to LightDB state.
	err = golioth_stream_push_cb(client, "my_stream_int",
				     GOLIOTH_CONTENT_FORMAT_APP_CBOR,
				     "15", sizeof("15") - 1,
				     NULL, NULL);
	if (err) {
		LOG_WRN("Failed to push temperature: %d", err);
		return;
	}

	// We can register a callback for persistent settings. The Settings service
	// allows remote users to manage and push settings to devices.
	/* NOTE: this is done in client->on_connect() */

	// Now we'll just sit in a loop and update a LightDB state variable every
	// once in a while.
	LOG_INF("Entering endless loop");

	for (int i = 0; i < 5; i++) {
		LOG_INF("Sending hello! %d", counter);

		counter_set_async(counter);
		counter++;

		k_sleep(K_SECONDS(_loop_delay_s));
	}

	dfu_main();
}
```

## src/dfu.c
```c
/*
 * Copyright (c) 2021 Golioth, Inc.
 *
 * SPDX-License-Identifier: Apache-2.0
 */

#include <zephyr/logging/log.h>
LOG_MODULE_REGISTER(golioth_dfu, LOG_LEVEL_DBG);

#include <net/golioth/fw.h>
#include <net/golioth/system_client.h>
#include <samples/common/net_connect.h>

#include <stdlib.h>
#include <stdio.h>
#include <zephyr/logging/log_ctrl.h>
#include <zephyr/net/coap.h>
#include <zephyr/sys/reboot.h>

#include "dfu.h"
#include "flash.h"

K_SEM_DEFINE(sem_connected, 0, 1);
K_SEM_DEFINE(sem_downloading, 0, 1);
K_SEM_DEFINE(sem_downloaded, 0, 1);

#define REBOOT_DELAY_SEC	1

static struct golioth_client *client = GOLIOTH_SYSTEM_CLIENT_GET();

struct dfu_ctx {
	struct flash_img_context flash;
	char version[65];
	bool downloading_started;
};

static struct dfu_ctx update_ctx;
static enum golioth_dfu_result dfu_initial_result = GOLIOTH_DFU_RESULT_INITIAL;

static int data_received(struct golioth_req_rsp *rsp)
{
	struct dfu_ctx *dfu = rsp->user_data;
	bool last = rsp->get_next == NULL;
	int err;

	if (rsp->err) {
		LOG_ERR("Error while receiving FW data: %d", rsp->err);
		return 0;
	}

	LOG_DBG("Received %zu bytes at offset %zu%s", rsp->len, rsp->off,
		last ? " (last)" : "");

	if (rsp->off == 0) {
		err = flash_img_prepare(&dfu->flash);
		if (err) {
			return err;
		}
	}

	err = flash_img_buffered_write(&dfu->flash, rsp->data, rsp->len, last);
	if (err) {
		LOG_ERR("Failed to write to flash: %d", err);
		return err;
	}

	if (last) {
		k_sem_give(&sem_downloaded);
	}

	if (rsp->get_next) {
		rsp->get_next(rsp->get_next_data, 0);
	}

	return 0;
}

static uint8_t *uri_strip_leading_slash(uint8_t *uri, size_t *uri_len)
{
	if (*uri_len > 0 && uri[0] == '/') {
		(*uri_len)--;
		return &uri[1];
	}

	return uri;
}

static int golioth_desired_update(struct golioth_req_rsp *rsp)
{
	struct dfu_ctx *dfu = rsp->user_data;
	size_t version_len = sizeof(dfu->version) - 1;
	uint8_t uri[64];
	uint8_t *uri_p;
	size_t uri_len = sizeof(uri);
	int err;

	if (rsp->err) {
		LOG_ERR("Error while receiving desired FW update: %d", rsp->err);
		return 0;
	}

	LOG_HEXDUMP_DBG(rsp->data, rsp->len, "Desired");

	/*
	 * Make sure that we don't start new firmware download and don't overwrite desired version
	 * which is accessed by main thread.
	 */
	if (dfu->downloading_started) {
		LOG_WRN("Ignoring new desired firmware, as downloading already started");
		return 0;
	}

	err = golioth_fw_desired_parse(rsp->data, rsp->len,
				       dfu->version, &version_len,
				       uri, &uri_len);
	switch (err) {
	case 0:
		break;
	case -ENOENT:
		LOG_INF("No release rolled out yet");
		return 0;
	default:
		LOG_ERR("Failed to parse desired version: %d", err);
		return err;
	}

	dfu->version[version_len] = '\0';

	if (version_len == strlen(current_version_str) &&
	    !strncmp(current_version_str, dfu->version, version_len)) {
		LOG_INF("Desired version (%s) matches current firmware version!",
			current_version_str);
		return -EALREADY;
	}

	uri_p = uri_strip_leading_slash(uri, &uri_len);

	k_sem_give(&sem_downloading);
	dfu->downloading_started = true;

	err = golioth_fw_download(client, uri_p, uri_len, data_received, dfu);
	if (err) {
		LOG_ERR("Failed to request firmware: %d", err);
		return err;
	}

	return 0;
}

void dfu_on_connect(struct golioth_client *client)
{
	int err;

	k_sem_give(&sem_connected);

	err = golioth_fw_observe_desired(client, golioth_desired_update, &update_ctx);
	if (err) {
		LOG_ERR("Failed to start observation of desired FW: %d", err);
	}
}

void dfu_main(void)
{
	int err;

	if (!boot_is_img_confirmed()) {
		/*
		 * There is no shared context between previous update request
		 * and current boot, so treat current image 'confirmed' flag as
		 * an indication whether previous update process was successful
		 * or not.
		 */
		dfu_initial_result = GOLIOTH_DFU_RESULT_FIRMWARE_UPDATED_SUCCESSFULLY;

		err = boot_write_img_confirmed();
		if (err) {
			LOG_ERR("Failed to confirm image: %d", err);
		}
	}

	k_sem_take(&sem_connected, K_FOREVER);

	err = golioth_fw_report_state(client, "main",
				      current_version_str,
				      NULL,
				      GOLIOTH_FW_STATE_IDLE,
				      dfu_initial_result);
	if (err) {
		LOG_ERR("Failed to report firmware state: %d", err);
	}

	k_sem_take(&sem_downloading, K_FOREVER);

	err = golioth_fw_report_state(client, "main",
				      current_version_str,
				      update_ctx.version,
				      GOLIOTH_FW_STATE_DOWNLOADING,
				      GOLIOTH_DFU_RESULT_INITIAL);
	if (err) {
		LOG_ERR("Failed to update to '%s' state: %d", "downloading", err);
	}

	k_sem_take(&sem_downloaded, K_FOREVER);

	err = golioth_fw_report_state(client, "main",
				      current_version_str,
				      update_ctx.version,
				      GOLIOTH_FW_STATE_DOWNLOADED,
				      GOLIOTH_DFU_RESULT_INITIAL);
	if (err) {
		LOG_ERR("Failed to update to '%s' state: %d", "downloaded", err);
	}

	err = golioth_fw_report_state(client, "main",
				      current_version_str,
				      update_ctx.version,
				      GOLIOTH_FW_STATE_UPDATING,
				      GOLIOTH_DFU_RESULT_INITIAL);
	if (err) {
		LOG_ERR("Failed to update to '%s' state: %d", "updating", err);
	}

	LOG_INF("Requesting upgrade");

	err = boot_request_upgrade(BOOT_UPGRADE_TEST);
	if (err) {
		LOG_ERR("Failed to request upgrade: %d", err);
		return;
	}

	LOG_INF("Rebooting in %d second(s)", REBOOT_DELAY_SEC);

	/* Synchronize logs */
	LOG_PANIC();

	k_sleep(K_SECONDS(REBOOT_DELAY_SEC));

	sys_reboot(SYS_REBOOT_COLD);
}
```

## src/dfu.h
```c
#ifndef __DFU_H__
#define __DFU_H__

struct golioth_client;

#ifdef CONFIG_BOOTLOADER_MCUBOOT

void dfu_on_connect(struct golioth_client *client);
void dfu_main(void);

#else /* CONFIG_BOOTLOADER_MCUBOOT */

static inline void dfu_on_connect(struct golioth_client *client) {}
static inline void dfu_main(void) {}

#endif /* CONFIG_BOOTLOADER_MCUBOOT */

#endif /* __DFU_H__ */
```

## src/flash.c
```c
/*
 * Copyright (c) 2021 Golioth, Inc.
 *
 * SPDX-License-Identifier: Apache-2.0
 */

#include <zephyr/logging/log.h>
LOG_MODULE_DECLARE(golioth_dfu);

#include <stdio.h>
#include <zephyr/storage/flash_map.h>

#include "flash.h"

#include <golioth/compat/init.h>

#ifdef CONFIG_TRUSTED_EXECUTION_NONSECURE
#define SLOT0_LABEL	slot0_ns_partition
#else
#define SLOT0_LABEL	slot0_partition
#endif /* CONFIG_TRUSTED_EXECUTION_NONSECURE */

/* FIXED_PARTITION_ID() values used below are auto-generated by DT */
#define FLASH_AREA_IMAGE_PRIMARY FIXED_PARTITION_ID(SLOT0_LABEL)

char current_version_str[sizeof("255.255.65535")];

static int current_version_init(void)
{
	struct mcuboot_img_header hdr;
	int written;
	int err;

	err = boot_read_bank_header(FLASH_AREA_IMAGE_PRIMARY, &hdr, sizeof(hdr));
	if (err) {
		LOG_ERR("Failed to read primary area (%u) header: %d",
			FLASH_AREA_IMAGE_PRIMARY, err);
		return err;
	}

	written = snprintf(current_version_str, sizeof(current_version_str),
			   "%u.%u.%u",
			   (unsigned int) hdr.h.v1.sem_ver.major,
			   (unsigned int) hdr.h.v1.sem_ver.minor,
			   (unsigned int) hdr.h.v1.sem_ver.revision);
	if (written >= sizeof(current_version_str)) {
		LOG_ERR("Version string is too long!");
		current_version_str[0] = '\0';
		return -ENOMEM;
	}

	return 0;
}

SYS_INIT(current_version_init, APPLICATION, CONFIG_APPLICATION_INIT_PRIORITY);

/*
 * @note This is a copy of ERASED_VAL_32() from mcumgr.
 */
#define ERASED_VAL_32(x) (((x) << 24) | ((x) << 16) | ((x) << 8) | (x))

/**
 * Determines if the specified area of flash is completely unwritten.
 *
 * @note This is a copy of zephyr_img_mgmt_flash_check_empty() from mcumgr.
 */
static int flash_area_check_empty(const struct flash_area *fa,
				  bool *out_empty)
{
	uint32_t data[16];
	off_t addr;
	off_t end;
	int bytes_to_read;
	int rc;
	int i;
	uint8_t erased_val;
	uint32_t erased_val_32;

	__ASSERT_NO_MSG(fa->fa_size % 4 == 0);

	erased_val = flash_area_erased_val(fa);
	erased_val_32 = ERASED_VAL_32(erased_val);

	end = fa->fa_size;
	for (addr = 0; addr < end; addr += sizeof(data)) {
		if (end - addr < sizeof(data)) {
			bytes_to_read = end - addr;
		} else {
			bytes_to_read = sizeof(data);
		}

		rc = flash_area_read(fa, addr, data, bytes_to_read);
		if (rc != 0) {
			flash_area_close(fa);
			return rc;
		}

		for (i = 0; i < bytes_to_read / 4; i++) {
			if (data[i] != erased_val_32) {
				*out_empty = false;
				flash_area_close(fa);
				return 0;
			}
		}
	}

	*out_empty = true;

	return 0;
}

static int flash_img_erase_if_needed(struct flash_img_context *ctx)
{
	bool empty;
	int err;

	if (IS_ENABLED(CONFIG_IMG_ERASE_PROGRESSIVELY)) {
		return 0;
	}

	err = flash_area_check_empty(ctx->flash_area, &empty);
	if (err) {
		return err;
	}

	if (empty) {
		return 0;
	}

	err = flash_area_erase(ctx->flash_area, 0, ctx->flash_area->fa_size);
	if (err) {
		return err;
	}

	return 0;
}

static const char *swap_type_str(int swap_type)
{
	switch (swap_type) {
	case BOOT_SWAP_TYPE_NONE:
		return "none";
	case BOOT_SWAP_TYPE_TEST:
		return "test";
	case BOOT_SWAP_TYPE_PERM:
		return "perm";
	case BOOT_SWAP_TYPE_REVERT:
		return "revert";
	case BOOT_SWAP_TYPE_FAIL:
		return "fail";
	}

	return "unknown";
}

int flash_img_prepare(struct flash_img_context *flash)
{
	int swap_type;
	int err;

	swap_type = mcuboot_swap_type();
	switch (swap_type) {
	case BOOT_SWAP_TYPE_REVERT:
		LOG_WRN("'revert' swap type detected, it is not safe to continue");
		return -EBUSY;
	default:
		LOG_INF("swap type: %s", swap_type_str(swap_type));
		break;
	}

	err = flash_img_init(flash);
	if (err) {
		LOG_ERR("failed to init: %d", err);
		return err;
	}

	err = flash_img_erase_if_needed(flash);
	if (err) {
		LOG_ERR("failed to erase: %d", err);
		return err;
	}

	return 0;
}
```

## src/flash.h
```c
/*
 * Copyright (c) 2021 Golioth, Inc.
 *
 * SPDX-License-Identifier: Apache-2.0
 */

#ifndef __APP_FLASH_H__
#define __APP_FLASH_H__

#ifdef CONFIG_BOOTLOADER_MCUBOOT

#include <zephyr/dfu/flash_img.h>
#include <zephyr/dfu/mcuboot.h>
#include <zephyr/types.h>

int flash_img_prepare(struct flash_img_context *flash);

extern char current_version_str[sizeof("255.255.65535")];

#else /* CONFIG_BOOTLOADER_MCUBOOT */

#include <stdbool.h>
#include <stddef.h>
#include <stdint.h>

struct flash_img_context {
	/* empty */
};

static inline int flash_img_prepare(struct flash_img_context *flash)
{
	return 0;
}

static inline
int flash_img_buffered_write(struct flash_img_context *ctx, const uint8_t *data,
			     size_t len, bool flush)
{
	return 0;
}

/** Boot upgrade request modes */
#define BOOT_UPGRADE_TEST       0
#define BOOT_UPGRADE_PERMANENT  1

static inline int boot_request_upgrade(int permanent)
{
	return 0;
}

static inline bool boot_is_img_confirmed(void)
{
	return true;
}

static inline int boot_write_img_confirmed(void)
{
	return 0;
}

char current_version_str[sizeof("255.255.65535")] = "1.0.0";

#endif /* CONFIG_BOOTLOADER_MCUBOOT */

#endif /* __APP_FLASH_H__ */
```

## src/lightdb_helpers.c
```c
/*
 * Copyright (c) 2022 Golioth, Inc.
 *
 * SPDX-License-Identifier: Apache-2.0
 */

#include <qcbor/qcbor.h>
#include <qcbor/qcbor_spiffy_decode.h>
#include <qcbor/posix_error_map.h>

#include <net/golioth.h>
#include "lightdb_helpers.h"

int golioth_lightdb_get_basic(struct golioth_client *client, const uint8_t *path,
			      void *value_void,
			      void (*get)(QCBORDecodeContext *dec, void *value_void))
{
	QCBORDecodeContext dec;
	uint8_t buf_raw[16];
	UsefulBufC buf = { buf_raw, ARRAY_SIZE(buf_raw) };
	QCBORError qerr;
	int err;

	err = golioth_lightdb_get(client, path, GOLIOTH_CONTENT_FORMAT_APP_CBOR,
				  buf_raw, &buf.len);
	if (err) {
		return err;
	}

	QCBORDecode_Init(&dec, buf, QCBOR_DECODE_MODE_NORMAL);

	get(&dec, value_void);

	qerr = QCBORDecode_Finish(&dec);
	if (qerr != QCBOR_SUCCESS) {
		return qcbor_error_to_posix(qerr);
	}

	return 0;
}

#define LIGHTDB_GET_SIMPLE_DEFINE(_type, _get)				\
void golioth_lightdb_qcbor_get_##_type(QCBORDecodeContext *dec,		\
				       void *value_void)		\
{									\
	_type *value = value_void;					\
									\
	_get(dec, value);						\
}

LIGHTDB_GET_SIMPLE_DEFINE(bool, QCBORDecode_GetBool);
LIGHTDB_GET_SIMPLE_DEFINE(int64_t, QCBORDecode_GetInt64);
LIGHTDB_GET_SIMPLE_DEFINE(uint64_t, QCBORDecode_GetUInt64);
LIGHTDB_GET_SIMPLE_DEFINE(double, QCBORDecode_GetDouble);

int golioth_lightdb_get_int64_t_clamp(struct golioth_client *client, const uint8_t *path,
				      int64_t *value, int64_t min, int64_t max)
{
	int err;

	err = golioth_lightdb_get_basic(client, path, value,
					golioth_lightdb_qcbor_get_int64_t);
	if (err) {
		return err;
	}

	if (*value > max) {
		*value = max;
		return -ERANGE;
	}

	if (*value < min) {
		*value = min;
		return -ERANGE;
	}

	return 0;
}

int golioth_lightdb_get_uint64_t_clamp(struct golioth_client *client, const uint8_t *path,
				       uint64_t *value, uint64_t max)
{
	int err;

	err = golioth_lightdb_get_basic(client, path, value,
					golioth_lightdb_qcbor_get_uint64_t);
	if (err) {
		return err;
	}

	if (*value > max) {
		*value = max;
		return -ERANGE;
	}

	return 0;
}

int golioth_lightdb_set_basic(struct golioth_client *client, const uint8_t *path,
			      const void *value_void,
			      void (*add)(QCBOREncodeContext *enc,
					  const void *value_void))
{
	QCBOREncodeContext enc;
	UsefulBuf_MAKE_STACK_UB(buf, 16);
	QCBORError qerr;
	size_t encoded_len;

	QCBOREncode_Init(&enc, buf);

	add(&enc, value_void);

	qerr = QCBOREncode_FinishGetSize(&enc, &encoded_len);
	if (qerr != QCBOR_SUCCESS) {
		return qcbor_error_to_posix(qerr);
	}

	return golioth_lightdb_set(client, path, GOLIOTH_CONTENT_FORMAT_APP_CBOR,
				   buf.ptr, encoded_len);
}

#define LIGHTDB_SET_SIMPLE_DEFINE(_type, _encode)			\
void golioth_lightdb_qcbor_add_##_type(QCBOREncodeContext *enc,		\
			       const void *value_void)			\
{									\
	const _type *value = value_void;				\
									\
	_encode(enc, *value);						\
}

LIGHTDB_SET_SIMPLE_DEFINE(bool, QCBOREncode_AddBool);
LIGHTDB_SET_SIMPLE_DEFINE(int64_t, QCBOREncode_AddInt64);
LIGHTDB_SET_SIMPLE_DEFINE(uint64_t, QCBOREncode_AddUInt64);
LIGHTDB_SET_SIMPLE_DEFINE(float, QCBOREncode_AddFloat);
LIGHTDB_SET_SIMPLE_DEFINE(double, QCBOREncode_AddDouble);

void golioth_lightdb_qcbor_add_stringz(QCBOREncodeContext *enc,
				       const void *value_void)
{
	const char *value = value_void;

	QCBOREncode_AddSZString(enc, value);
}
```

## src/lightdb_helpers_priv.h
```c
#ifndef __INCLUDE_NET_GOLIOTH_LIGHTDB_HELPERS_PRIV_H__
#define __INCLUDE_NET_GOLIOTH_LIGHTDB_HELPERS_PRIV_H__

#include <stdint.h>

struct golioth_client;

struct _QCBORDecodeContext;
typedef struct _QCBORDecodeContext QCBORDecodeContext;

struct _QCBOREncodeContext;
typedef struct _QCBOREncodeContext QCBOREncodeContext;

int golioth_lightdb_get_basic(struct golioth_client *client, const uint8_t *path,
			      void *value_void,
			      void (*get)(QCBORDecodeContext *dec, void *value_void));

int golioth_lightdb_get_int64_t_clamp(struct golioth_client *client, const uint8_t *path,
				      int64_t *value, int64_t min, int64_t max);
int golioth_lightdb_get_uint64_t_clamp(struct golioth_client *client, const uint8_t *path,
				       uint64_t *value, uint64_t max);

void golioth_lightdb_qcbor_get_bool(QCBORDecodeContext *dec, void *value_void);
void golioth_lightdb_qcbor_get_int64_t(QCBORDecodeContext *dec, void *value_void);
void golioth_lightdb_qcbor_get_uint64_t(QCBORDecodeContext *dec, void *value_void);
void golioth_lightdb_qcbor_get_double(QCBORDecodeContext *dec, void *value_void);

int golioth_lightdb_set_basic(struct golioth_client *client, const uint8_t *path,
			      const void *value_void,
			      void (*add)(QCBOREncodeContext *enc,
					  const void *value_void));

void golioth_lightdb_qcbor_add_bool(QCBOREncodeContext *enc, const void *value_void);
void golioth_lightdb_qcbor_add_int64_t(QCBOREncodeContext *enc, const void *value_void);
void golioth_lightdb_qcbor_add_uint64_t(QCBOREncodeContext *enc, const void *value_void);
void golioth_lightdb_qcbor_add_float(QCBOREncodeContext *enc, const void *value_void);
void golioth_lightdb_qcbor_add_double(QCBOREncodeContext *enc, const void *value_void);
void golioth_lightdb_qcbor_add_stringz(QCBOREncodeContext *enc, const void *value_void);

#endif /* __INCLUDE_NET_GOLIOTH_LIGHTDB_HELPERS_PRIV_H__ */
```
